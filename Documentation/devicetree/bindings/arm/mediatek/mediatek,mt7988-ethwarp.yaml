## arch/arm64/configs/rk3568_bpi-r2p_defconfig
```kconfig
#CONFIG_LOCALVERSION="-bpi-r2-pro"
CONFIG_LOCALVERSION_AUTO=n

CONFIG_DEFAULT_HOSTNAME="(rk3568)"

CONFIG_DEBUG_INFO=y
CONFIG_DEBUG_INFO_REDUCED=y
CONFIG_MAGIC_SYSRQ=y
CONFIG_DEBUG_FS=y
CONFIG_DEBUG_KERNEL=y

CONFIG_SYSVIPC=y
CONFIG_POSIX_MQUEUE=y
CONFIG_AUDIT=y
CONFIG_GENERIC_IRQ_DEBUGFS=y
CONFIG_NO_HZ_IDLE=y
CONFIG_HIGH_RES_TIMERS=y
CONFIG_BPF_JIT=y
CONFIG_PREEMPT=y
CONFIG_IRQ_TIME_ACCOUNTING=y
#CONFIG_BSD_PROCESS_ACCT=y
#CONFIG_BSD_PROCESS_ACCT_V3=y
CONFIG_TASKSTATS=y
CONFIG_TASK_DELAY_ACCT=y
CONFIG_TASK_XACCT=y
CONFIG_TASK_IO_ACCOUNTING=y
CONFIG_IKCONFIG=y
CONFIG_IKCONFIG_PROC=y
CONFIG_LOG_BUF_SHIFT=18
CONFIG_NUMA_BALANCING=y
CONFIG_MEMCG=y
CONFIG_BLK_CGROUP=y
CONFIG_CGROUP_PIDS=y
CONFIG_CGROUP_HUGETLB=y
CONFIG_CPUSETS=y
CONFIG_CGROUP_DEVICE=y
CONFIG_CGROUP_CPUACCT=y
CONFIG_CGROUP_PERF=y
CONFIG_CGROUP_MISC=y
CONFIG_USER_NS=y
CONFIG_SCHED_CORE=y
CONFIG_SCHED_AUTOGROUP=y
CONFIG_KALLSYMS_ALL=y
# CONFIG_COMPAT_BRK is not set
CONFIG_PROFILING=y
CONFIG_ARCH_ROCKCHIP=y
CONFIG_SCHED_MC=y
CONFIG_SCHED_SMT=y
CONFIG_NUMA=y
CONFIG_KEXEC=y
CONFIG_KEXEC_FILE=y
CONFIG_CRASH_DUMP=y
#CONFIG_XEN=y
CONFIG_RANDOMIZE_BASE=y
#CONFIG_HIBERNATION=y
CONFIG_WQ_POWER_EFFICIENT_DEFAULT=y
CONFIG_ENERGY_MODEL=y
CONFIG_ARM_CPUIDLE=y
CONFIG_ARM_PSCI_CPUIDLE=y
CONFIG_CPU_FREQ=y
CONFIG_CPU_FREQ_STAT=y
CONFIG_CPU_FREQ_GOV_POWERSAVE=m
CONFIG_CPU_FREQ_GOV_USERSPACE=y
CONFIG_CPU_FREQ_GOV_ONDEMAND=y
CONFIG_CPU_FREQ_GOV_CONSERVATIVE=m
CONFIG_CPUFREQ_DT=y
#CONFIG_ACPI_CPPC_CPUFREQ=m
CONFIG_ARM_SCPI_CPUFREQ=y
CONFIG_ARM_SCMI_CPUFREQ=y
CONFIG_ACPI=y
CONFIG_ACPI_PROCESSOR=y

#CONFIG_ACPI_APEI=y
#CONFIG_ACPI_APEI_GHES=y
#CONFIG_ACPI_APEI_MEMORY_FAILURE=y
#CONFIG_ACPI_APEI_EINJ=y
#CONFIG_VIRTUALIZATION=y
#CONFIG_KVM=y
CONFIG_ARM64_CRYPTO=y
CONFIG_CRYPTO_SHA1_ARM64_CE=y
CONFIG_CRYPTO_SHA2_ARM64_CE=y
CONFIG_CRYPTO_SHA512_ARM64_CE=m
CONFIG_CRYPTO_SHA3_ARM64=m
CONFIG_CRYPTO_SM3_ARM64_CE=m
CONFIG_CRYPTO_GHASH_ARM64_CE=y
CONFIG_CRYPTO_CRCT10DIF_ARM64_CE=m
CONFIG_CRYPTO_AES_ARM64=y
CONFIG_CRYPTO_AES_ARM64_CE_CCM=y
CONFIG_CRYPTO_AES_ARM64_CE_BLK=y
CONFIG_CRYPTO_CHACHA20_NEON=m
CONFIG_CRYPTO_AES_ARM64_BS=m
CONFIG_JUMP_LABEL=y
CONFIG_COMPAT_32BIT_TIME=y
CONFIG_MODULES=y
CONFIG_MODULE_UNLOAD=y
# CONFIG_CORE_DUMP_DEFAULT_ELF_HEADERS is not set
#CONFIG_KSM=y
CONFIG_MEMORY_FAILURE=y
#CONFIG_TRANSPARENT_HUGEPAGE=y
#CONFIG_FRONTSWAP=y
#CONFIG_CMA=y
#CONFIG_ZSWAP=y
#CONFIG_ZSWAP_COMPRESSOR_DEFAULT_ZSTD=y
#CONFIG_ZSWAP_ZPOOL_DEFAULT_ZSMALLOC=y
#CONFIG_ZSWAP_DEFAULT_ON=y
CONFIG_TMPFS=y
CONFIG_DEVTMPFS=y
CONFIG_DEVTMPFS_MOUNT=y
CONFIG_VFAT_FS=y
CONFIG_NLS_CODEPAGE_437=y
CONFIG_NLS_ISO8859_1=y
CONFIG_EXT4_FS=y

CONFIG_BLK_DEV_INITRD=y
CONFIG_CRYPTO_LZ4=y
CONFIG_ZRAM=y
CONFIG_ZRAM_MEMORY_TRACKING=y
CONFIG_BLK_DEV_LOOP=y
CONFIG_BLK_DEV_NBD=m
CONFIG_BLK_DEV_RAM=y

CONFIG_COMMON_CLK_ROCKCHIP=y
CONFIG_CLK_RK3568=y
CONFIG_ROCKCHIP_IODOMAIN=y
CONFIG_PM_GENERIC_DOMAINS=y
CONFIG_ROCKCHIP_PM_DOMAINS=y

CONFIG_NEW_LEDS=y
CONFIG_LEDS_CLASS=y
CONFIG_LEDS_GPIO=y

CONFIG_I2C=y
CONFIG_I2C_RK3X=y
CONFIG_I2C_CHARDEV=y
CONFIG_I2C_MUX=y

CONFIG_PWM=y
CONFIG_PWM_ROCKCHIP=y
CONFIG_SPI=y
CONFIG_SPI_SPIDEV=y
CONFIG_SPI_ROCKCHIP=y

CONFIG_WATCHDOG=y
CONFIG_WATCHDOG_NOWAYOUT=y
CONFIG_WATCHDOG_SYSFS=y
CONFIG_DW_WATCHDOG=y

CONFIG_NVMEM=y
CONFIG_ROCKCHIP_EFUSE=y
CONFIG_THERMAL=y
CONFIG_ROCKCHIP_THERMAL=y
CONFIG_THERMAL_HWMON=y
CONFIG_CPU_THERMAL=y

CONFIG_SERIAL_8250=y
CONFIG_SERIAL_8250_CONSOLE=y
CONFIG_SERIAL_8250_EXTENDED=y
CONFIG_SERIAL_8250_SHARE_IRQ=y
CONFIG_SERIAL_8250_DW=y
CONFIG_SERIAL_OF_PLATFORM=y

CONFIG_MMC=y
CONFIG_MMC_SDHCI=y
CONFIG_MMC_DW=y
CONFIG_MMC_DW_ROCKCHIP=y
CONFIG_PHY_ROCKCHIP_EMMC=y
CONFIG_MMC_SDHCI_PLTFM=y
CONFIG_MMC_SDHCI_OF_DWCMSHC=y

CONFIG_NET=y
CONFIG_PACKET=y
CONFIG_UNIX=y
CONFIG_INET=y
CONFIG_BRIDGE=y
CONFIG_BRIDGE_VLAN_FILTERING=y
CONFIG_NETDEVICES=y
CONFIG_ETHERNET=y
CONFIG_NET_VENDOR_ARC=y
CONFIG_REGULATOR=y
CONFIG_STMMAC_ETH=y
CONFIG_EMAC_ROCKCHIP=y
CONFIG_ROCKCHIP_PHY=y
CONFIG_COMMON_CLK_RK808=y
CONFIG_MFD_RK808=y
CONFIG_REGULATOR_RK808=y
CONFIG_REGULATOR_GPIO=y
CONFIG_PINCTRL_RK805=y
CONFIG_REGULATOR_FIXED_VOLTAGE=y
CONFIG_RTC_CLASS=y
CONFIG_RTC_DRV_RK808=y
CONFIG_RTC_DRV_HYM8563=y

CONFIG_PCI=y
CONFIG_PCI_MSI_IRQ_DOMAIN=y
CONFIG_PCIE_ROCKCHIP_HOST=y
CONFIG_PCIE_ROCKCHIP_DW_HOST=y
CONFIG_PCI_ENDPOINT=y
CONFIG_PCIE_ROCKCHIP_EP=y
CONFIG_PHY_ROCKCHIP_PCIE=y
CONFIG_PHY_ROCKCHIP_SNPS_PCIE3=y

CONFIG_USB=y
CONFIG_USB_XHCI_HCD=y
CONFIG_USB_EHCI_HCD=y
CONFIG_USB_EHCI_HCD_PLATFORM=y
CONFIG_USB_OHCI_HCD=y
CONFIG_USB_OHCI_HCD_PLATFORM=y
CONFIG_USB_CONN_GPIO=y
CONFIG_USB_OTG=y
CONFIG_EXTCON=y
CONFIG_PHY_ROCKCHIP_USB=y
CONFIG_PHY_ROCKCHIP_INNO_USB2=y
CONFIG_PHY_ROCKCHIP_NANENG_COMBO_PHY=y
CONFIG_USB_STORAGE=y
CONFIG_USB_DWC3=y
CONFIG_USB_DWC2=y

CONFIG_ATA=y
CONFIG_SATA_AHCI=y
CONFIG_SATA_AHCI_PLATFORM=y
CONFIG_SATA_DWC=y
CONFIG_BLK_DEV_SD=y

CONFIG_DRM=y
CONFIG_ROCKCHIP_IOMMU=y
CONFIG_DRM_ROCKCHIP=y
CONFIG_ROCKCHIP_DW_HDMI=y
CONFIG_PHY_ROCKCHIP_INNO_HDMI=y
CONFIG_ROCKCHIP_INNO_HDMI=y

CONFIG_INPUT_MOUSEDEV=y
CONFIG_INPUT_EVDEV=y

CONFIG_NET_DSA=y

#vendor driver
CONFIG_RTL8367RB_GSW=y
#reduced phy driver
CONFIG_NET_REALTEK_MDIO=y
#real dsa driver
CONFIG_NET_DSA_REALTEK=y
CONFIG_MT753X_GSW=y
```

## bpi-r2pro.its
```
/*
 * Copyright (C) 2020 Rockchip Electronics Co., Ltd
 *
 * SPDX-License-Identifier: GPL-2.0
 */

/dts-v1/;

/ {
	description = "U-Boot fitImage for bpi-r2pro aarch64 kernel";
	images {
		kernel {
			description = "Linux Kernel %version%";
			data = /incbin/("arch/arm64/boot/Image.gz");
			type = "kernel";
			arch = "arm64";
			os = "linux";
			compression = "gzip";
			entry = <0x02080000>;
			load = <0x02080000>;
			hash {
				algo = "sha256";
			};
		};
		fdt {
			description = "Flattened Device Tree blob";
			data = /incbin/("arch/arm64/boot/dts/rockchip/rk3568-bpi-r2-pro.dtb");
			type = "flat_dt";
			arch = "arm64";
			compression = "none";
			hash {
				algo = "sha256";
			};
		};
/*		ramdisk {
			data = /incbin/("out/ramdisk");
			type = "ramdisk";
			arch = "arm64";
			os = "linux";
			compression = "none";
			load = <0xffffff02>;
			hash {
				algo = "sha256";
			};
		};*/
	};
	configurations {
		default = "conf";
		conf {
			fdt = "fdt";
			kernel = "kernel";
			//ramdisk = "ramdisk";
		};
	};
};
```

## bpi-r3.its
```
/dts-v1/;

/ {
	description = "U-Boot fitImage for bpi-r3 aarch64 kernel";
	#address-cells = <1>;

	images {
		kernel-1 {
			description = "Linux Kernel %version%";
			data = /incbin/("./arch/arm64/boot/Image.gz");
			type = "kernel";
			arch = "arm64";
			os = "linux";
			compression = "gzip";
			load = <0x44000000>;
			entry = <0x44000000>;
			hash-1 {
				algo = "sha1";
			};
		};
		fdt-base {
			description = "Flattened Device Tree blob";
			data = /incbin/("./arch/arm64/boot/dts/mediatek/mt7986a-bananapi-bpi-r3.dtb");
			type = "flat_dt";
			arch = "arm64";
			load = <0x47000000>;
			compression = "none";
			hash-1 {
				algo = "sha1";
			};
		};
		fdt-ov-sd {
			description = "Flattened Device Tree blob";
			data = /incbin/("./arch/arm64/boot/dts/mediatek/mt7986a-bananapi-bpi-r3-sd.dtbo");
			type = "flat_dt";
		};
		fdt-ov-emmc {
			description = "Flattened Device Tree blob";
			data = /incbin/("./arch/arm64/boot/dts/mediatek/mt7986a-bananapi-bpi-r3-emmc.dtbo");
			type = "flat_dt";
		};
		fdt-ov-nand{
			data = /incbin/("./arch/arm64/boot/dts/mediatek/mt7986a-bananapi-bpi-r3-nand.dtbo");
			type = "flat_dt";
			arch = "arm64";
		};
		fdt-ov-nor{
			data = /incbin/("./arch/arm64/boot/dts/mediatek/mt7986a-bananapi-bpi-r3-nor.dtbo");
			type = "flat_dt";
			arch = "arm64";
		};
/*		ramdisk-1 {
			description = "ramdisk";
			data = /incbin/("./rootfs_arm64.cpio.gz");
			type = "ramdisk";
			arch = "arm64";
			os = "linux";
			compression = "gzip";
			hash-1 {
				algo = "sha1";
			};
		};*/
	};
	configurations {
		default = "conf-sd";
		conf-sd {
			description = "Boot Linux kernel with SD FDT blob";
			kernel = "kernel-1";
			fdt = "fdt-base", "fdt-ov-sd";
			//ramdisk = "ramdisk-1";
			hash-1 {
				algo = "sha1";
			};
		};
		conf-emmc {
			description = "Boot Linux kernel with EMMC FDT blob";
			kernel = "kernel-1";
			fdt = "fdt-base", "fdt-ov-emmc";
			//ramdisk = "ramdisk-1";
			hash-1 {
				algo = "sha1";
			};
		};
		conf-sd-nand {
			description = "Boot Linux kernel with SD+NAND FDT blob";
			kernel = "kernel-1";
			fdt = "fdt-base", "fdt-ov-sd", "fdt-ov-nand";
			//ramdisk = "ramdisk-1";
			hash-1 {
				algo = "sha1";
			};
		};
		conf-emmc-nand {
			description = "Boot Linux kernel with EMMC+NAND FDT blob";
			kernel = "kernel-1";
			fdt = "fdt-base", "fdt-ov-emmc", "fdt-ov-nand";
			//ramdisk = "ramdisk-1";
			hash-1 {
				algo = "sha1";
			};
		};
		conf-sd-nor {
			description = "Boot Linux kernel with SD+NOR FDT blob";
			kernel = "kernel-1";
			fdt = "fdt-base", "fdt-ov-sd", "fdt-ov-nor";
			//ramdisk = "ramdisk-1";
			hash-1 {
				algo = "sha1";
			};
		};
		conf-emmc-nor {
			description = "Boot Linux kernel with EMMC+NOR FDT blob";
			kernel = "kernel-1";
			fdt = "fdt-base", "fdt-ov-emmc", "fdt-ov-nor";
			//ramdisk = "ramdisk-1";
			hash-1 {
				algo = "sha1";
			};
		};
	};
};
```

## bpi-r64.its
```
/dts-v1/;

/ {
	description = "U-Boot fitImage for bpi-r64 aarch64 kernel";
	#address-cells = <1>;

	images {
		kernel-1 {
			description = "Linux Kernel %version%";
			data = /incbin/("./arch/arm64/boot/Image");
			type = "kernel";
			arch = "arm64";
			os = "linux";
			compression = "none";
			load = <0x40080000>;
			entry = <0x40080000>;
			hash-1 {
				algo = "sha1";
			};
		};
		fdt-1 {
			description = "Flattened Device Tree blob";
			data = /incbin/("./arch/arm64/boot/dts/mediatek/mt7622-bananapi-bpi-r64.dtb");
			type = "flat_dt";
			arch = "arm64";
			compression = "none";
			hash-1 {
				algo = "sha1";
			};
		};
/*		ramdisk@0 {
			description = "ramdisk";
			data = /incbin/("./ramdisk.cpio");
			type = "ramdisk";
			arch = "arm64";
			os = "linux";
			compression = "none";
			hash@1 {
				algo = "sha1";
			};
		};*/
	};
	configurations {
		default = "conf-1";
		conf-1 {
			description = "Boot Linux kernel with FDT blob";
			kernel = "kernel-1";
			fdt = "fdt-1";
			//ramdisk = "ramdisk@0";
			hash-1 {
				algo = "sha1";
			};
		};
	};
};
```

## drivers/mtd/mtdrw/Kconfig
```kconfig
config MTD_RW
	tristate "Module to make all MTD partitions writeable"
	default n
	help
		Say M here to build a module which, upon loading, will make
		all read-only MTD partitions writeable. Do not say Y here.

		If unsure, say N.
```

## drivers/net/ethernet/mediatek/Kconfig
```kconfig
# SPDX-License-Identifier: GPL-2.0-only
config NET_VENDOR_MEDIATEK
	bool "MediaTek devices"
	depends on ARCH_MEDIATEK || SOC_MT7621 || SOC_MT7620 || COMPILE_TEST
	help
	  If you have a Mediatek SoC with ethernet, say Y.

if NET_VENDOR_MEDIATEK

config NET_MEDIATEK_SOC_WED
	depends on ARCH_MEDIATEK || COMPILE_TEST
	def_bool NET_MEDIATEK_SOC != n

config NET_MEDIATEK_SOC
	tristate "MediaTek SoC Gigabit Ethernet support"
	depends on NET_DSA || !NET_DSA
	select PINCTRL
	select PHYLINK
	select DIMLIB
	select PAGE_POOL
	select PAGE_POOL_STATS
	select PCS_MTK_LYNXI
	select REGMAP_MMIO
	help
	  This driver supports the gigabit ethernet MACs in the
	  MediaTek SoC family.

config NET_MEDIATEK_SOC_USXGMII
	bool "Support USXGMII SerDes on MT7988"
	depends on (ARCH_MEDIATEK && ARM64) || COMPILE_TEST
	def_bool NET_MEDIATEK_SOC != n
	help
	  Include support for 10G SerDes which can be found on MT7988.
	  If this kernel should run on SoCs with 10 GBit/s Ethernet you
	  will need to select this option to use GMAC2 and GMAC3 with
	  external PHYs, SFP(+) cages in 10000Base-R, 5000Base-R or
	  USXGMII interface mode.

	  Note that as the 2500Base-X/1000Base-X/Cisco SGMII SerDes PCS
	  unit (MediaTek LynxI) in MT7988 is connected via the new 10GE
	  SerDes, you will also need to select this option in case you
	  want to use any of those SerDes modes.

config NET_MEDIATEK_STAR_EMAC
	tristate "MediaTek STAR Ethernet MAC support"
	select PHYLIB
	select REGMAP_MMIO
	help
	  This driver supports the ethernet MAC IP first used on
	  MediaTek MT85** SoCs.

endif #NET_VENDOR_MEDIATEK
```
