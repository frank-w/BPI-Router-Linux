## arch/arm/configs/mt7623n_fwu_owrt_defconfig
```kconfig
CONFIG_32BIT=y
CONFIG_64BIT_TIME=y
CONFIG_ADVISE_SYSCALLS=y
CONFIG_AEABI=y
CONFIG_AIO=y
CONFIG_ALLOW_DEV_COREDUMP=y
CONFIG_ANON_INODES=y
CONFIG_ARCH_BINFMT_ELF_STATE=y
CONFIG_ARCH_FLATMEM_ENABLE=y
CONFIG_ARCH_MMAP_RND_BITS=8
CONFIG_ARCH_MMAP_RND_BITS_MAX=16
CONFIG_ARCH_MMAP_RND_BITS_MIN=8
CONFIG_ARCH_MMAP_RND_COMPAT_BITS_MAX=16
CONFIG_ARCH_MMAP_RND_COMPAT_BITS_MIN=8
CONFIG_ARM64_SW_TTBR0_PAN=y
CONFIG_ARM_CPU_TOPOLOGY=y
CONFIG_ARM_DMA_MEM_BUFFERABLE=y
CONFIG_ARM_GIC_MAX_NR=1
CONFIG_ATAGS_PROC=y
CONFIG_ATA_BMDMA=y
CONFIG_ATA_SFF=y
CONFIG_ATM_BR2684_IPFILTER=y
CONFIG_ATM_CLIP_NO_ICMP=y
CONFIG_BASE_FULL=y
CONFIG_BASE_SMALL=0
CONFIG_BCMA_POSSIBLE=y
CONFIG_BINFMT_ELF=y
CONFIG_BINFMT_SCRIPT=y
CONFIG_BITREVERSE=y
CONFIG_BLK_DEV=y
CONFIG_BLK_DEV_INITRD=y
CONFIG_BLK_DEV_LOOP_MIN_COUNT=8
CONFIG_BLOCK=y
CONFIG_BOOKE_WDT_DEFAULT_TIMEOUT=3
CONFIG_BOOT_RAW=y
CONFIG_BPF=y
CONFIG_BPF_JIT=y
CONFIG_BPF_JIT_DEFAULT_ON=y
CONFIG_BPF_SYSCALL=y
CONFIG_BPF_UNPRIV_DEFAULT_OFF=y
CONFIG_BQL=y
CONFIG_BRANCH_PROFILE_NONE=y
CONFIG_BRIDGE=y
CONFIG_BRIDGE_IGMP_SNOOPING=y
CONFIG_BRIDGE_VLAN_FILTERING=y
CONFIG_BROKEN_ON_SMP=y
CONFIG_BT_BNEP_MC_FILTER=y
CONFIG_BT_BNEP_PROTO_FILTER=y
CONFIG_BT_HCIUART_BCSP=y
CONFIG_BT_HCIUART_H4=y
CONFIG_BUG=y
CONFIG_BUILDTIME_EXTABLE_SORT=y
CONFIG_BUILDTIME_TABLE_SORT=y
CONFIG_BUILD_SALT=""
CONFIG_CACHE_L2X0_PMU=y
CONFIG_CARDBUS=y
CONFIG_CC_CAN_LINK=y
CONFIG_CC_OPTIMIZE_FOR_PERFORMANCE=y
CONFIG_CIFS_ALLOW_INSECURE_LEGACY=y
CONFIG_CIFS_POSIX=y
CONFIG_CIFS_XATTR=y
CONFIG_CLS_U32_MARK=y
CONFIG_COMPACTION=y
CONFIG_CONSOLE_LOGLEVEL_DEFAULT=7
CONFIG_CONSOLE_LOGLEVEL_QUIET=4
CONFIG_CONSTRUCTORS=y
CONFIG_CPU_LITTLE_ENDIAN=y
CONFIG_CPU_SW_DOMAIN_PAN=y
CONFIG_CRAMFS_BLOCKDEV=y
CONFIG_CRC32=y
CONFIG_CRC32_SARWATE=y
CONFIG_CROSS_COMPILE=""
CONFIG_CRYPTO=y
CONFIG_CRYPTO_ACOMP2=y
CONFIG_CRYPTO_AEAD=y
CONFIG_CRYPTO_AEAD2=y
CONFIG_CRYPTO_AES=y
CONFIG_CRYPTO_AKCIPHER=y
CONFIG_CRYPTO_AKCIPHER2=y
CONFIG_CRYPTO_ALGAPI=y
CONFIG_CRYPTO_ALGAPI2=y
CONFIG_CRYPTO_CCM=y
CONFIG_CRYPTO_CTR=y
CONFIG_CRYPTO_GCM=y
CONFIG_CRYPTO_GF128MUL=y
CONFIG_CRYPTO_GHASH=y
CONFIG_CRYPTO_HASH=y
CONFIG_CRYPTO_HASH2=y
CONFIG_CRYPTO_KPP=y
CONFIG_CRYPTO_KPP2=y
CONFIG_CRYPTO_LIB_AES=y
CONFIG_CRYPTO_LIB_ARC4=y
CONFIG_CRYPTO_LIB_POLY1305_RSIZE=9
CONFIG_CRYPTO_MANAGER=y
CONFIG_CRYPTO_MANAGER2=y
CONFIG_CRYPTO_MANAGER_DISABLE_TESTS=y
CONFIG_CRYPTO_NULL=y
CONFIG_CRYPTO_NULL2=y
CONFIG_CRYPTO_PCRYPT=y
CONFIG_CRYPTO_SKCIPHER=y
CONFIG_CRYPTO_SKCIPHER2=y
CONFIG_DEBUG_FS=y
CONFIG_DEBUG_FS_ALLOW_ALL=y
CONFIG_DEBUG_INFO_REDUCED=y
CONFIG_DEBUG_KERNEL=y
CONFIG_DEFAULT_CUBIC=y
CONFIG_DEFAULT_DEADLINE=y
CONFIG_DEFAULT_FQ_CODEL=y
CONFIG_DEFAULT_HOSTNAME="(none)"
CONFIG_DEFAULT_HUNG_TASK_TIMEOUT=120
CONFIG_DEFAULT_INIT=""
CONFIG_DEFAULT_MMAP_MIN_ADDR=4096
CONFIG_DEFAULT_NET_SCH="fq_codel"
CONFIG_DEFAULT_SECURITY=""
CONFIG_DEFAULT_SECURITY_DAC=y
CONFIG_DEFAULT_TCP_CONG="cubic"
CONFIG_DEFCONFIG_LIST="/lib/modules/$UNAME_RELEASE/.config"
CONFIG_DEVPORT=y
CONFIG_DMA_COHERENT_POOL=y
CONFIG_DMA_DECLARE_COHERENT=y
CONFIG_DMA_NONCOHERENT_MMAP=y
CONFIG_DOUBLEFAULT=y
CONFIG_DQL=y
CONFIG_DUMMY_CONSOLE_COLUMNS=80
CONFIG_DUMMY_CONSOLE_ROWS=25
CONFIG_DVB_MAX_ADAPTERS=16
CONFIG_DYNAMIC_DEBUG_CORE=y
CONFIG_EFI_PARTITION=y
CONFIG_ELFCORE=y
CONFIG_EMBEDDED=y
CONFIG_ENABLE_WARN_DEPRECATED=y
CONFIG_EPOLL=y
CONFIG_ETHERNET=y
CONFIG_ETHTOOL_NETLINK=y
CONFIG_EVENTFD=y
CONFIG_EXPERT=y
CONFIG_EXPORTFS=y
CONFIG_EXT2_FS_XATTR=y
CONFIG_EXT4_USE_FOR_EXT2=y
CONFIG_EXTRA_FIRMWARE=""
CONFIG_EXTRA_TARGETS=""
CONFIG_F2FS_FS_XATTR=y
CONFIG_F2FS_STAT_FS=y
CONFIG_FAT_DEFAULT_CODEPAGE=437
CONFIG_FAT_DEFAULT_IOCHARSET="iso8859-1"
CONFIG_FB_NOTIFY=y
CONFIG_FIB_RULES=y
CONFIG_FILE_LOCKING=y
CONFIG_FLATMEM=y
CONFIG_FLATMEM_MANUAL=y
CONFIG_FLAT_NODE_MEM_MAP=y
CONFIG_FORCE_MAX_ZONEORDER=11
CONFIG_FORTIFY_SOURCE=y
CONFIG_FRAME_WARN=1024
CONFIG_FSNOTIFY=y
CONFIG_FUTEX=y
CONFIG_FUTEX_PI=y
CONFIG_FW_LOADER=y
CONFIG_FW_LOADER_USER_HELPER=y
CONFIG_FW_LOADER_USER_HELPER_FALLBACK=y
CONFIG_GACT_PROB=y
CONFIG_GENERIC_CALIBRATE_DELAY=y
CONFIG_GENERIC_HWEIGHT=y
CONFIG_GENERIC_IRQ_IPI=y
CONFIG_GENERIC_IRQ_PROBE=y
CONFIG_GENERIC_NET_UTILS=y
CONFIG_GENERIC_PTDUMP=y
CONFIG_GENERIC_VDSO_TIME_NS=y
CONFIG_GPIOLIB_FASTPATH_LIMIT=512
CONFIG_GPIO_SYSFS=y
CONFIG_HARDENED_USERCOPY=y
CONFIG_HARDEN_EL2_VECTORS=y
CONFIG_HIGH_RES_TIMERS=y
CONFIG_HPET_MMAP_DEFAULT=y
CONFIG_HW_PERF_EVENTS=y
CONFIG_HW_RANDOM_TPM=y
CONFIG_HZ=100
CONFIG_HZ_100=y
CONFIG_IIO_CONSUMERS_PER_TRIGGER=2
CONFIG_INET=y
CONFIG_INIT_ENV_ARG_LIMIT=32
CONFIG_INIT_STACK_NONE=y
CONFIG_INOTIFY_USER=y
CONFIG_INPUT_MISC=y
CONFIG_IO_STRICT_DEVMEM=y
CONFIG_IO_WQ=y
CONFIG_IPV6_NDISC_NODETYPE=y
CONFIG_IPW2100_MONITOR=y
CONFIG_IPW2200_MONITOR=y
CONFIG_IP_ADVANCED_ROUTER=y
CONFIG_IP_MROUTE_MULTIPLE_TABLES=y
CONFIG_IP_MULTICAST=y
CONFIG_IP_MULTIPLE_TABLES=y
CONFIG_IP_ROUTE_MULTIPATH=y
CONFIG_IP_ROUTE_VERBOSE=y
CONFIG_IP_VS_MH_TAB_INDEX=10
CONFIG_ISDN=y
CONFIG_JFFS2_CMODE_PRIORITY=y
CONFIG_JFFS2_COMPRESSION_OPTIONS=y
CONFIG_JFFS2_FS=y
CONFIG_JFFS2_FS_DEBUG=0
CONFIG_JFFS2_FS_WRITEBUFFER=y
CONFIG_JFFS2_FS_XATTR=y
CONFIG_JFFS2_LZMA=y
CONFIG_JFFS2_RTIME=y
CONFIG_JFFS2_SUMMARY=y
CONFIG_JOLIET=y
CONFIG_KALLSYMS_BASE_RELATIVE=y
CONFIG_KASAN_STACK=1
CONFIG_NEON=y
CONFIG_KERNEL_MODE_NEON=y
CONFIG_KERNEL_XZ=y
CONFIG_KERNFS=y
CONFIG_KUSER_HELPERS=y
CONFIG_LBDAF=y
CONFIG_LDISC_AUTOLOAD=y
CONFIG_LD_DEAD_CODE_DATA_ELIMINATION=y
CONFIG_LEDS_BRIGHTNESS_HW_CHANGED=y
CONFIG_LEDS_CLASS=y
CONFIG_LEDS_CLASS_MULTICOLOR=y
CONFIG_LEDS_TRIGGERS=y
CONFIG_LEDS_TRIGGER_DEFAULT_ON=y
CONFIG_LEDS_TRIGGER_HEARTBEAT=y
CONFIG_LEDS_TRIGGER_NETDEV=y
CONFIG_LEDS_TRIGGER_TIMER=y
CONFIG_LINEAR_RANGES=y
CONFIG_LLC=y
CONFIG_LOCKDEP_SUPPORT=y
CONFIG_LOCKD_V4=y
CONFIG_LOG_BUF_SHIFT=17
CONFIG_LOG_CPU_MAX_BUF_SHIFT=12
CONFIG_LSM="lockdown,yama,loadpin,safesetid,integrity"
CONFIG_LSM_MMAP_MIN_ADDR=65536
CONFIG_LZMA_COMPRESS=y
CONFIG_LZMA_DECOMPRESS=y
CONFIG_MAC80211_STA_HASH_MAX_SIZE=0
CONFIG_MAGIC_SYSRQ_DEFAULT_ENABLE=0x1
CONFIG_MAGIC_SYSRQ_SERIAL_SEQUENCE=""
CONFIG_MAY_USE_DEVLINK=y
CONFIG_MEMBARRIER=y
CONFIG_MESSAGE_LOGLEVEL_DEFAULT=4
CONFIG_MII=y
CONFIG_MISC_FILESYSTEMS=y
CONFIG_MMC_BLOCK_BOUNCE=y
CONFIG_MMC_BLOCK_MINORS=8
CONFIG_MMU=y
CONFIG_MMU_GATHER_RCU_TABLE_FREE=y
CONFIG_MMU_GATHER_TABLE_FREE=y
CONFIG_MODULES=y
CONFIG_MODULE_STRIPPED=y
CONFIG_MODULE_UNLOAD=y
CONFIG_MSDOS_PARTITION=y
CONFIG_MTD=y
CONFIG_MTD_BLKDEVS=y
CONFIG_MTD_BLOCK=y
CONFIG_MTD_CFI=y
CONFIG_MTD_CFI_AMDSTD=y
CONFIG_MTD_CFI_I1=y
CONFIG_MTD_CFI_I2=y
CONFIG_MTD_CFI_INTELEXT=y
CONFIG_MTD_CFI_NOSWAP=y
CONFIG_MTD_CFI_UTIL=y
CONFIG_MTD_COMPLEX_MAPPINGS=y
CONFIG_MTD_GEN_PROBE=y
CONFIG_MTD_MAP_BANK_WIDTH_1=y
CONFIG_MTD_MAP_BANK_WIDTH_2=y
CONFIG_MTD_MAP_BANK_WIDTH_4=y
CONFIG_MTD_NAND_DENALI_SCRATCH_REG_ADDR=0xff108018
CONFIG_MTD_NAND_IDS=y
CONFIG_MTD_OF_PARTS=y
CONFIG_MTD_PHYSMAP_OF=y
CONFIG_MTD_REDBOOT_DIRECTORY_BLOCK=-1
CONFIG_MTD_ROOTFS_ROOT_DEV=y
CONFIG_MTD_SPI_NOR_USE_4K_SECTORS_LIMIT=4096
CONFIG_MTD_SPLIT=y
CONFIG_MTD_SPLIT_FIRMWARE_NAME="firmware"
CONFIG_MTD_SPLIT_SQUASHFS_ROOT=y
CONFIG_MTD_SPLIT_SUPPORT=y
CONFIG_MULTIUSER=y
CONFIG_NET=y
CONFIG_NETDEVICES=y
CONFIG_NETWORK_FILESYSTEMS=y
CONFIG_NET_CADENCE=y
CONFIG_NET_CLS=y
CONFIG_NET_CLS_IND=y
CONFIG_NET_CORE=y
CONFIG_NET_EMATCH_STACK=32
CONFIG_NET_IPGRE_BROADCAST=y
CONFIG_NET_RX_BUSY_POLL=y
CONFIG_NET_SCHED=y
CONFIG_NET_SCH_DEFAULT=y
CONFIG_NET_SCH_FIFO=y
CONFIG_NEW_LEDS=y
CONFIG_NFSD_V3=y
CONFIG_NFS_COMMON=y
CONFIG_NFS_V3=y
CONFIG_NF_CONNTRACK_PROCFS=y
CONFIG_NF_NAT_MASQUERADE_IPV4=y
CONFIG_NF_NAT_MASQUERADE_IPV6=y
CONFIG_NF_TABLES_ARP=y
CONFIG_NF_TABLES_BRIDGE=y
CONFIG_NF_TABLES_INET=y
CONFIG_NF_TABLES_IPV4=y
CONFIG_NF_TABLES_IPV6=y
CONFIG_NF_TABLES_NETDEV=y
CONFIG_NLATTR=y
CONFIG_NLS_DEFAULT="iso8859-1"
CONFIG_NMI_LOG_BUF_SHIFT=13
CONFIG_OF_RESERVED_MEM=y
CONFIG_OPTIMIZE_INLINING=y
CONFIG_OVERLAY_FS=y
CONFIG_OVERLAY_FS_REDIRECT_ALWAYS_FOLLOW=y
CONFIG_OVERLAY_FS_XINO_AUTO=y
CONFIG_PACKET=y
CONFIG_PAGE_SIZE_4KB=y
#CONFIG_PANIC_ON_OOPS=y
CONFIG_PANIC_ON_OOPS_VALUE=0
CONFIG_PANIC_TIMEOUT=0
CONFIG_PARTITION_ADVANCED=y
CONFIG_PCIE_BUS_DEFAULT=y
CONFIG_PCI_QUIRKS=y
CONFIG_PCI_SYSCALL=y
CONFIG_PINCONF=y
CONFIG_PINCTRL_SINGLE=y
CONFIG_PINMUX=y
CONFIG_POSIX_TIMERS=y
CONFIG_PPC_4K_PAGES=y
CONFIG_PPP_FILTER=y
CONFIG_PPP_MULTILINK=y
CONFIG_PREEMPT_NONE=y
CONFIG_PREVENT_FIRMWARE_BUILD=y
CONFIG_PRINTK=y
CONFIG_PRINTK_NMI=y
CONFIG_PRINTK_SAFE_LOG_BUF_SHIFT=13
CONFIG_PRINT_STACK_DEPTH=64
CONFIG_PROC_FS=y
CONFIG_PROC_SYSCTL=y
CONFIG_PWRSEQ_EMMC=y
CONFIG_PWRSEQ_SIMPLE=y
CONFIG_RCU_CPU_STALL_TIMEOUT=21
CONFIG_RCU_KTHREAD_PRIO=0
CONFIG_RCU_NEED_SEGCBLIST=y
CONFIG_RCU_STALL_COMMON=y
CONFIG_RCU_TORTURE_TEST_SLOW_INIT_DELAY=3
CONFIG_REISERFS_FS_XATTR=y
CONFIG_RFKILL=y
CONFIG_RTC_DRV_CMOS=y
CONFIG_RTC_HCTOSYS=y
CONFIG_RTC_HCTOSYS_DEVICE="rtc0"
CONFIG_RTC_INTF_DEV=y
CONFIG_RTC_INTF_PROC=y
CONFIG_RTC_INTF_SYSFS=y
CONFIG_RTC_LIB=y
CONFIG_RTC_SYSTOHC=y
CONFIG_RTC_SYSTOHC_DEVICE="rtc0"
CONFIG_RT_MUTEXES=y
CONFIG_RUNTIME_TESTING_MENU=y
CONFIG_RWSEM_GENERIC_SPINLOCK=y
CONFIG_RXKAD=y
CONFIG_SATA_MOBILE_LPM_POLICY=0
CONFIG_SBITMAP=y
CONFIG_SCHED_HRTICK=y
CONFIG_SCHED_OMIT_FRAME_POINTER=y
CONFIG_SCSI_DMA=y
CONFIG_SCSI_LOWLEVEL=y
CONFIG_SCSI_MOD=y
CONFIG_SCSI_PROC_FS=y
CONFIG_SECTION_MISMATCH_WARN_ONLY=y
CONFIG_SECURITY_DMESG_RESTRICT=y
CONFIG_SECURITY_SELINUX_CHECKREQPROT_VALUE=0
CONFIG_SELECT_MEMORY_MODEL=y
CONFIG_SERIAL_8250=y
CONFIG_SERIAL_8250_CONSOLE=y
CONFIG_SERIAL_8250_DMA=y
CONFIG_SERIAL_8250_NR_UARTS=4
CONFIG_SERIAL_8250_RUNTIME_UARTS=4
CONFIG_SERIAL_CORE=y
CONFIG_SERIAL_CORE_CONSOLE=y
CONFIG_SERIAL_EARLYCON=y
CONFIG_SHMEM=y
CONFIG_SIGNALFD=y
CONFIG_SLABINFO=y
CONFIG_SLAB_MERGE_DEFAULT=y
CONFIG_SLUB=y
CONFIG_SLUB_CPU_PARTIAL=y
CONFIG_SND_DRIVERS=y
CONFIG_SND_HDA_POWER_SAVE_DEFAULT=0
CONFIG_SND_HDA_PREALLOC_SIZE=64
CONFIG_SND_MAX_CARDS=16
CONFIG_SND_OSSEMUL=y
CONFIG_SND_PCI=y
CONFIG_SND_PCM_OSS_PLUGINS=y
CONFIG_SND_PROC_FS=y
CONFIG_SND_SOC_INTEL_SST_TOPLEVEL=y
CONFIG_SND_USB=y
CONFIG_SND_VERBOSE_PROCFS=y
CONFIG_SND_X86=y
CONFIG_SPLIT_PTLOCK_CPUS=4
CONFIG_SQUASHFS=y
CONFIG_SQUASHFS_DECOMP_MULTI_PERCPU=y
CONFIG_SQUASHFS_EMBEDDED=y
CONFIG_SQUASHFS_FILE_DIRECT=y
CONFIG_SQUASHFS_FRAGMENT_CACHE_SIZE=3
CONFIG_SQUASHFS_XZ=y
CONFIG_SSB_POSSIBLE=y
CONFIG_STACKTRACE_SUPPORT=y
CONFIG_STAGING=y
CONFIG_STANDALONE=y
CONFIG_STDBINUTILS=y
CONFIG_STP=y
CONFIG_STRICT_KERNEL_RWX=y
CONFIG_STRICT_MODULE_RWX=y
CONFIG_STRIP_ASM_SYMS=y
CONFIG_SUNRPC_DISABLE_INSECURE_ENCTYPES=y
CONFIG_SWAP=y
CONFIG_SYMBOLIC_ERRNAME=y
CONFIG_SYN_COOKIES=y
CONFIG_SYSCTL=y
CONFIG_SYSFS=y
CONFIG_SYSTEM_TRUSTED_KEYS=""
CONFIG_SYSVIPC=y
CONFIG_SYSVIPC_SYSCTL=y
CONFIG_TCP_CONG_ADVANCED=y
CONFIG_TCP_CONG_CUBIC=y
CONFIG_TEXTSEARCH=y
CONFIG_THIN_ARCHIVES=y
CONFIG_TICK_ONESHOT=y
CONFIG_TIMERFD=y
CONFIG_TINY_RCU=y
CONFIG_TMPFS=y
CONFIG_TMPFS_XATTR=y
CONFIG_TRACE_IRQFLAGS_SUPPORT=y
CONFIG_TRACING_SUPPORT=y
CONFIG_TRAD_SIGNALS=y
CONFIG_TTY=y
CONFIG_UBIFS_FS_LZO=y
CONFIG_UBIFS_FS_XATTR=y
CONFIG_UBIFS_FS_ZLIB=y
CONFIG_UBIFS_FS_ZSTD=y
CONFIG_UBSAN_ALIGNMENT=y
CONFIG_UEVENT_HELPER=y
CONFIG_UEVENT_HELPER_PATH="/sbin/hotplug"
CONFIG_UID16=y
CONFIG_UNIX=y
CONFIG_UNIX98_PTYS=y
CONFIG_UNIX_SCM=y
CONFIG_USBIP_VHCI_HC_PORTS=8
CONFIG_USBIP_VHCI_NR_HCS=1
CONFIG_USB_ALI_M5632=y
CONFIG_USB_AN2720=y
CONFIG_USB_ARCH_HAS_HCD=y
CONFIG_USB_ARMLINUX=y
CONFIG_USB_AUTOSUSPEND_DELAY=2
CONFIG_USB_BELKIN=y
CONFIG_USB_DEFAULT_PERSIST=y
CONFIG_USB_EHCI_ROOT_HUB_TT=y
CONFIG_USB_EHCI_TT_NEWSCHED=y
CONFIG_USB_GADGET_STORAGE_NUM_BUFFERS=2
CONFIG_USB_GADGET_VBUS_DRAW=2
CONFIG_USB_OHCI_LITTLE_ENDIAN=y
CONFIG_USB_SERIAL_GENERIC=y
CONFIG_USB_SERIAL_KEYSPAN_MPR=y
CONFIG_USB_SERIAL_KEYSPAN_USA18X=y
CONFIG_USB_SERIAL_KEYSPAN_USA19=y
CONFIG_USB_SERIAL_KEYSPAN_USA19QI=y
CONFIG_USB_SERIAL_KEYSPAN_USA19QW=y
CONFIG_USB_SERIAL_KEYSPAN_USA19W=y
CONFIG_USB_SERIAL_KEYSPAN_USA28=y
CONFIG_USB_SERIAL_KEYSPAN_USA28X=y
CONFIG_USB_SERIAL_KEYSPAN_USA28XA=y
CONFIG_USB_SERIAL_KEYSPAN_USA28XB=y
CONFIG_USB_SERIAL_KEYSPAN_USA49W=y
CONFIG_USB_SERIAL_KEYSPAN_USA49WLC=y
CONFIG_USB_SERIAL_SAFE_PADDED=y
CONFIG_USB_VIDEO_CLASS_INPUT_EVDEV=y
CONFIG_VDSO=y
CONFIG_VHOST_MENU=y
CONFIG_VIRTIO_MENU=y
CONFIG_VIRT_TO_BUS=y
CONFIG_VLAN_8021Q=y
CONFIG_VMSPLIT_3G=y
CONFIG_WATCHDOG=y
CONFIG_WATCHDOG_HANDLE_BOOT_ENABLED=y
CONFIG_WATCHDOG_OPEN_TIMEOUT=0
CONFIG_WEXT_CORE=y
CONFIG_WEXT_PRIV=y
CONFIG_WEXT_PROC=y
CONFIG_WEXT_SPY=y
CONFIG_WILINK_PLATFORM_DATA=y
CONFIG_WIRELESS=y
CONFIG_WIRELESS_EXT=y
CONFIG_WLAN=y
CONFIG_WQ_POWER_EFFICIENT_DEFAULT=y
CONFIG_X86_SYSFB=y
CONFIG_XEN_SCRUB_PAGES_DEFAULT=y
CONFIG_XFRM=y
CONFIG_XZ_DEC=y
CONFIG_ZONE_DMA=y
CONFIG_LOCALVERSION="-bpi-r2"
CONFIG_LOCALVERSION_AUTO=n

CONFIG_EARLY_PRINTK=y

#spectre/meltdown
CONFIG_PAGE_TABLE_ISOLATION=y

CONFIG_IRQ_DOMAIN_DEBUG=y
CONFIG_NO_HZ=y
CONFIG_CGROUPS=y
CONFIG_NAMESPACES=y

#for lxc
CONFIG_USER_NS=y
CONFIG_MEMCG=y
CONFIG_CGROUP_CPUACCT=y
CONFIG_CGROUP_DEVICE=y
CONFIG_CGROUP_SCHED=y
CONFIG_CPUSETS=y
#some options for docker
CONFIG_CGROUP_FREEZER=y
CONFIG_MEMCG_SWAP=y
CONFIG_MEMCG_SWAP_ENABLED=y
CONFIG_BLK_CGROUP=y
CONFIG_CFS_BANDWIDTH=y
CONFIG_RT_GROUP_SCHED=y
CONFIG_CGROUP_PIDS=y
CONFIG_CGROUP_PERF=y
CONFIG_CGROUP_NET_CLASSID=y
CONFIG_CGROUP_NET_PRIO=y
CONFIG_CFQ_GROUP_IOSCHED=y

CONFIG_KALLSYMS_ALL=y
CONFIG_PERF_EVENTS=y
CONFIG_CMDLINE_PARTITION=y
CONFIG_ARCH_MEDIATEK=y
CONFIG_ARM_THUMB=y
CONFIG_ARM_THUMBEE=y
CONFIG_ARM_ERRATA_720789=y
CONFIG_ARM_ERRATA_754322=y
CONFIG_ARM_ERRATA_754327=y
CONFIG_ARM_ERRATA_764369=y
CONFIG_ARM_ERRATA_775420=y
CONFIG_ARM_ERRATA_798181=y

CONFIG_PL310_ERRATA_588369=y
CONFIG_PL310_ERRATA_727915=y
CONFIG_PL310_ERRATA_753970=y
CONFIG_PL310_ERRATA_769419=y

CONFIG_PCI=y
CONFIG_PCI_MSI=y
CONFIG_SMP=y
CONFIG_HAVE_ARM_ARCH_TIMER=y
CONFIG_NR_CPUS=16
CONFIG_HIGHMEM=y
CONFIG_CMA=y
CONFIG_ARM_APPENDED_DTB=y
CONFIG_ARM_ATAG_DTB_COMPAT=y
CONFIG_CMDLINE="earlyprintk console=ttyS0,115200 vmalloc=496M debug=7 no_console_suspend"
#CONFIG_CMDLINE_FORCE=y

CONFIG_IKCONFIG=m
CONFIG_IKCONFIG_PROC=y

CONFIG_KEXEC=y

CONFIG_CPU_FREQ=y
CONFIG_CPU_FREQ_STAT=y
CONFIG_CPU_FREQ_DEFAULT_GOV_USERSPACE=y
CONFIG_CPU_FREQ_GOV_PERFORMANCE=y
CONFIG_CPU_FREQ_GOV_POWERSAVE=y
CONFIG_CPU_FREQ_GOV_ONDEMAND=y
CONFIG_CPU_FREQ_GOV_CONSERVATIVE=y
CONFIG_CPU_FREQ_GOV_SCHEDUTIL=y
CONFIG_ARM_MEDIATEK_CPUFREQ=y

CONFIG_VFP=y
CONFIG_PM_AUTOSLEEP=y
CONFIG_PM_DEBUG=y
CONFIG_PM_ADVANCED_DEBUG=y
CONFIG_APM_EMULATION=y

CONFIG_DUMMY=m
CONFIG_IP_PNP=y
CONFIG_IP_PNP_DHCP=y
CONFIG_IP_PNP_BOOTP=y
CONFIG_IP_PNP_RARP=y
CONFIG_IPV6_ROUTER_PREF=y
CONFIG_IPV6_OPTIMISTIC_DAD=y
CONFIG_INET6_AH=m
CONFIG_INET6_ESP=m
CONFIG_INET6_IPCOMP=m
CONFIG_IPV6_MIP6=m
CONFIG_IPV6_TUNNEL=m
CONFIG_IPV6_MULTIPLE_TABLES=y
CONFIG_NET_DSA=y
CONFIG_NETLINK_DIAG=y
CONFIG_INET_UDP_DIAG=m
CONFIG_NET_IPIP=m
CONFIG_IP_MROUTE=y
CONFIG_IP_PIMSM_V1=y
CONFIG_IP_PIMSM_V2=y

#added for lxc
CONFIG_UNIX_DIAG=m
CONFIG_PACKET_DIAG=m

#added for docker
CONFIG_POSIX_MQUEUE=y
CONFIG_POSIX_MQUEUE_SYSCTL=y
CONFIG_HAVE_ARCH_SECCOMP_FILTER=y
CONFIG_SECCOMP_FILTER=y
CONFIG_SECCOMP=y

CONFIG_IPV6=y
CONFIG_NETFILTER=y
CONFIG_NF_CONNTRACK=m
CONFIG_NF_CONNTRACK_IPV4=m
CONFIG_NF_CONNTRACK_IPV6=m
CONFIG_NETFILTER_NETLINK=m
CONFIG_NF_CT_NETLINK=m
CONFIG_IP_NF_IPTABLES=m
CONFIG_NF_LOG_IPV4=m
CONFIG_NF_REJECT_IPV4=m
CONFIG_IP6_NF_IPTABLES=m
CONFIG_NF_LOG_IPV6=m
CONFIG_NF_REJECT_IPV6=m
CONFIG_IP_NF_NAT=m
CONFIG_IP6_NF_NAT=m
CONFIG_NF_NAT_MASQUERADE_IPV4=y
CONFIG_NF_NAT_MASQUERADE_IPV6=y
CONFIG_IP_NF_FILTER=m
CONFIG_IP6_NF_FILTER=m
CONFIG_IP_NF_TARGET_MASQUERADE=m
CONFIG_IP6_NF_TARGET_MASQUERADE=m
CONFIG_IP_NF_MANGLE=m
CONFIG_IP6_NF_MANGLE=m
CONFIG_IP_NF_TARGET_REJECT=m
CONFIG_IP6_NF_TARGET_REJECT=m
CONFIG_IP6_NF_MATCH_RT=m

CONFIG_NETFILTER_SYNPROXY=m
CONFIG_IP_NF_TARGET_SYNPROXY=m
CONFIG_IP6_NF_TARGET_SYNPROXY=m

CONFIG_NETFILTER_XT_TARGET_CHECKSUM=m
CONFIG_NETFILTER_XT_MATCH_LIMIT=m
CONFIG_NETFILTER_XT_MATCH_STATE=m
CONFIG_NETFILTER_XT_TARGET_LOG=m
CONFIG_NETFILTER_XT_TARGET_TCPOPTSTRIP=m
CONFIG_NETFILTER_XT_MATCH_CONNTRACK=m
CONFIG_NETFILTER_XT_MATCH_MAC=m
CONFIG_NETFILTER_XT_MATCH_RECENT=m
CONFIG_NETFILTER_XT_MATCH_IPRANGE=m
CONFIG_NETFILTER_XT_MARK=m
CONFIG_NETFILTER_XT_CONNMARK=m
CONFIG_NETFILTER_XT_MATCH_ADDRTYPE=m
CONFIG_IP_VS=m
CONFIG_NETFILTER_XT_MATCH_IPVS=m
CONFIG_NETFILTER_XT_MATCH_CONNLIMIT=m
#CONFIG_NETFILTER_XT_TARGET_NFQUEUE=m

CONFIG_NF_TABLES=m
CONFIG_NF_TABLES_SET=m
CONFIG_NF_TPROXY_IPV4=m
CONFIG_NF_TPROXY_IPV6=m
CONFIG_NFT_NUMGEN=m
CONFIG_NFT_CT=m
CONFIG_NFT_COUNTER=m
CONFIG_NFT_CONNLIMIT=m
CONFIG_NFT_LOG=m
CONFIG_NFT_LIMIT=m
CONFIG_NFT_MASQ=m
CONFIG_NFT_NAT=m
CONFIG_NFT_QUEUE=m
CONFIG_NFT_REDIR=m
CONFIG_NFT_TUNNEL=m
CONFIG_NFT_OBJREF=m
CONFIG_NFT_QUOTA=m
CONFIG_NFT_REJECT=m
CONFIG_NFT_COMPAT=m
CONFIG_NFT_HASH=m
CONFIG_NFT_XFRM=m
CONFIG_NFT_SOCKET=m
CONFIG_NFT_OSF=m
CONFIG_NFT_TPROXY=m
CONFIG_NFT_SYNPROXY=m
CONFIG_NFTL=m
CONFIG_NFTL_RW=y
CONFIG_NFT_FIB_INET=m

CONFIG_NFT_FIB_IPV4=m
CONFIG_NFT_FIB_IPV6=m

CONFIG_NF_FLOW_TABLE=m
CONFIG_NF_FLOW_TABLE_INET=m
CONFIG_NF_FLOW_TABLE_IPV4=m
CONFIG_NF_FLOW_TABLE_IPV6=m
CONFIG_NFT_FLOW_OFFLOAD=m

CONFIG_DEBUG_SECTION_MISMATCH=y

#active ftp-support
CONFIG_NF_CONNTRACK_FTP=m
CONFIG_NF_NAT_FTP=m

CONFIG_PPP=m
CONFIG_PPPOE=m
CONFIG_PPP_DEFLATE=m
CONFIG_PPP_MPPE=m

#veth for lxc
CONFIG_VETH=m

#for systemd
CONFIG_AF_KCM=y
CONFIG_CGROUP_BPF=y

CONFIG_DEVTMPFS=y
CONFIG_DEVTMPFS_MOUNT=y
CONFIG_DMA_CMA=y
CONFIG_CMA_SIZE_MBYTES=64
CONFIG_ARM_CCI400_PMU=y
CONFIG_OF_OVERLAY=y
CONFIG_CONFIGFS_FS=m
CONFIG_BLK_DEV_LOOP=y
CONFIG_SRAM=y
CONFIG_EEPROM_93CX6=y
CONFIG_IDE=y
CONFIG_BLK_DEV_SD=y
CONFIG_ATA=y
CONFIG_SATA_AHCI=y
CONFIG_AHCI_MTK=m

CONFIG_NET_DSA_MT7530=y
CONFIG_NET_VENDOR_MEDIATEK=y
CONFIG_NET_MEDIATEK_SOC=y

CONFIG_ICPLUS_PHY=y
CONFIG_INPUT_EVDEV=y
#CONFIG_INPUT_EVBUG=m
CONFIG_KEYBOARD_MATRIX=y
CONFIG_KEYBOARD_SAMSUNG=y
CONFIG_KEYBOARD_MTK_PMIC=m
CONFIG_MOUSE_PS2_ELANTECH=y
CONFIG_MOUSE_PS2_SENTELIC=y
CONFIG_INPUT_MOUSEDEV=y
CONFIG_INPUT_MOUSEDEV_PSAUX=y
CONFIG_INPUT_MOUSEDEV_SCREEN_X=1024
CONFIG_INPUT_MOUSEDEV_SCREEN_Y=768
CONFIG_INPUT_TOUCHSCREEN=y
# CONFIG_SERIO_SERPORT is not set
CONFIG_VT_HW_CONSOLE_BINDING=y
CONFIG_SERIAL_8250_MT6577=y
CONFIG_SERIAL_8250_BTIF=y
CONFIG_HW_RANDOM=y
CONFIG_I2C=y
CONFIG_I2C_MT65XX=y
CONFIG_PINCTRL_MT2701=y
# CONFIG_PINCTRL_MT6397 is not set
CONFIG_MEDIATEK_WATCHDOG=y
CONFIG_MFD_MT6397=y
CONFIG_REGULATOR=y
CONFIG_REGULATOR_MT6323=y
CONFIG_REGULATOR_FIXED_VOLTAGE=y
CONFIG_MEDIA_SUPPORT=y
CONFIG_MEDIA_RC_SUPPORT=y
CONFIG_RC_CORE=y
CONFIG_RC_DEVICES=y
CONFIG_LIRC=y
CONFIG_IR_MTK=y
CONFIG_RC_DECODERS=y
CONFIG_IR_NEC_DECODER=m
CONFIG_IR_RC5_DECODER=m
CONFIG_IR_RC6_DECODER=m
CONFIG_IR_JVC_DECODER=m
CONFIG_IR_SONY_DECODER=m
CONFIG_IR_SHARP_DECODER=m
CONFIG_IR_SANYO_DECODER=m
CONFIG_IR_RCMM_DECODER=m
CONFIG_IR_XMP_DECODER=m
CONFIG_MMC=y
CONFIG_MMC_MTK=y
CONFIG_LEDS_MT6323=y
CONFIG_LEDS_GPIO=y
CONFIG_LEDS_PCA963X=y
CONFIG_LEDS_TRIGGER_ONESHOT=y
CONFIG_DMADEVICES=y
CONFIG_DMATEST=m
CONFIG_COMMON_CLK_MT2701_HIFSYS=y
CONFIG_COMMON_CLK_MT2701_ETHSYS=y
CONFIG_ARM_TIMER_SP804=y
CONFIG_MTK_IOMMU_V1=y
CONFIG_MTK_PMIC_WRAP=y
CONFIG_IIO=y
CONFIG_RESET_CONTROLLER=y
CONFIG_PHY_MT65XX_USB3=y
CONFIG_PSTORE=y
CONFIG_PSTORE_CONSOLE=y
CONFIG_PSTORE_PMSG=y
CONFIG_PSTORE_FTRACE=y
CONFIG_PSTORE_RAM=y
CONFIG_PRINTK_TIME=y
CONFIG_DYNAMIC_DEBUG=y
CONFIG_DEBUG_INFO=y
CONFIG_MAGIC_SYSRQ=y
CONFIG_DETECT_HUNG_TASK=y
CONFIG_DEBUG_LIST=y
CONFIG_FUNCTION_TRACER=y
CONFIG_FTRACE_SYSCALLS=y
CONFIG_FUNCTION_PROFILER=y
CONFIG_DEBUG_LL=y
CONFIG_DEBUG_UART_PHYS=0x11002000
CONFIG_DEBUG_UART_VIRT=0xf1002000
CONFIG_KEYS=y
CONFIG_CRYPTO_RSA=y
CONFIG_CRYPTO_ECB=m
CONFIG_CRYPTO_CMAC=m
CONFIG_CRYPTO_ARC4=m
CONFIG_CRYPTO_DEFLATE=y
CONFIG_CRYPTO_LZO=y
CONFIG_CRC_CCITT=m
CONFIG_CRC_ITU_T=m
CONFIG_CRYPTO_DEV_MEDIATEK=y

#ARM Accelerated Cryptographic Algorithms
CONFIG_ARM_CRYPTO=y
CONFIG_CRYPTO_SHA1_ARM=m
CONFIG_CRYPTO_SHA1_ARM_NEON=m
CONFIG_CRYPTO_SHA1_ARM_CE=m
CONFIG_CRYPTO_SHA2_ARM_CE=m
CONFIG_CRYPTO_SHA512_ARM=m
CONFIG_CRYPTO_AES_ARM=m
CONFIG_CRYPTO_AES_ARM_BS=m
CONFIG_CRYPTO_AES_ARM_CE=m
CONFIG_CRYPTO_GHASH_ARM_CE=m
CONFIG_CRYPTO_CRC32_ARM_CE=m
CONFIG_CRYPTO_CHACHA20_NEON=m

#LVM
CONFIG_MD=y
CONFIG_BLK_DEV_DM=y
CONFIG_DM_BUFIO=y
CONFIG_DM_CRYPT=y
CONFIG_DM_SNAPSHOT=y
CONFIG_DM_MIRROR=y
CONFIG_DM_MULTIPATH=y
CONFIG_DM_MULTIPATH_QL=y
CONFIG_DM_MULTIPATH_ST=y
CONFIG_DM_THIN_PROVISIONING=m
CONFIG_DAX=y
CONFIG_CRYPTO_CBC=y

#RAID
CONFIG_DM_RAID=y
CONFIG_MD_RAID0=y
CONFIG_MD_RAID1=y
CONFIG_MD_RAID10=y
CONFIG_MD_RAID456=y

#RamFS
#CONFIG_INITRAMFS_SOURCE="utils/buildroot/rootfs_bpi-r2.cpio.gz"
#CONFIG_INITRAMFS_FORCE=y

#Filesystem
CONFIG_EXT4_FS=y
CONFIG_EXT4_FS_POSIX_ACL=y
CONFIG_EXT4_FS_SECURITY=y
CONFIG_AUTOFS4_FS=y
CONFIG_FUSE_FS=m
CONFIG_MSDOS_FS=m
CONFIG_VFAT_FS=y
CONFIG_NTFS_FS=m
CONFIG_TMPFS_POSIX_ACL=y
CONFIG_NLS_CODEPAGE_437=y
CONFIG_NLS_ISO8859_1=y
CONFIG_NLS_UTF8=y
CONFIG_CIFS=m
CONFIG_F2FS_FS=m
CONFIG_BTRFS_FS=m

#GPIO
CONFIG_DEBUG_GPIO=y

#wlan
CONFIG_MAC80211=y
CONFIG_MAC80211_MESH=y
CONFIG_CFG80211=m
CONFIG_CFG80211_WEXT=y

#internal wlan (not working yet)
# CONFIG_MTK_CONN_LTE_IDC_SUPPORT is not set
CONFIG_MTK_COMBO=y
CONFIG_MTK_COMBO_CHIP_CONSYS_7623=y
#used in 4.4, but should be set in Kconfig by selecting mt7623 COMBO
#CONFIG_MTK_PLATFORM="mt7623"

CONFIG_MTK_COMBO_COMM=y
CONFIG_MTK_COMBO_WIFI=y
CONFIG_NL80211_TESTMODE=y

#internal Bluetooth (also not working yet)
CONFIG_BT=y
CONFIG_MTK_COMBO_BT=m
CONFIG_MTK_COMBO_BT_HCI=y
#needed for BT?
#Bluetooth Classic (BR/EDR) features 
CONFIG_BT_BREDR=y
#Bluetooth High Speed (HS) features
CONFIG_BT_HS=y
#Bluetooth Low Energy (LE) features
CONFIG_BT_LE=y
#Export Bluetooth internals in debugfs
CONFIG_BT_DEBUGFS=y
CONFIG_BT_RFCOMM=m
CONFIG_BT_RFCOMM_TTY=y
CONFIG_BT_HIDP=m
CONFIG_BT_BNEP=m

#to run bluetoothd rfkill needed
CONFIG_RFKILL_LEDS=y
CONFIG_RFKILL_INPUT=y
CONFIG_RFKILL_GPIO=y

#if you use a mt76x2 or mt76x3 pcie-card
CONFIG_MT76x2E=m
CONFIG_MT7615E=m

#pcie
CONFIG_PCIEPORTBUS=y
CONFIG_PCIE_MEDIATEK=y
CONFIG_PHY_MTK_TPHY=y

CONFIG_I2C_CHARDEV=m
CONFIG_RTC_CLASS=y
CONFIG_RTC_DRV_DS1307=m
CONFIG_RTC_DRV_DS1307_CENTURY=y
CONFIG_RTC_DRV_MT6397=y

CONFIG_SPI=y
CONFIG_SPI_MASTER=y
CONFIG_SPI_SPIDEV=m
CONFIG_SPI_MT65XX=m

CONFIG_PWM=y
CONFIG_PWM_MEDIATEK=m

#Temperature sensor driver for mediatek SoCs
CONFIG_MEDIATEK_MT6577_AUXADC=m
CONFIG_THERMAL=y
CONFIG_MTK_THERMAL=m
CONFIG_MTK_EFUSE=m
CONFIG_HWMON=y
CONFIG_THERMAL_HWMON=y
CONFIG_CPU_THERMAL=y

#HDMI
CONFIG_DRM=y
CONFIG_DRM_ARM=y
CONFIG_DRM_MALI_DISPLAY=y
CONFIG_DRM_MEDIATEK=y
CONFIG_DRM_MEDIATEK_HDMI=y
CONFIG_COMMON_CLK_MT2701_MMSYS=y
CONFIG_COMMON_CLK_MT2701_IMGSYS=y
CONFIG_COMMON_CLK_MT2701_VDECSYS=y
CONFIG_FRAMEBUFFER_CONSOLE=y
CONFIG_DRM_FBDEV_EMULATION=y

#mali
CONFIG_MEDIA_CAMERA_SUPPORT=y
CONFIG_VIDEO_DEV=y
CONFIG_VIDEO_V4L2=y
CONFIG_V4L_MEM2MEM_DRIVERS=y
CONFIG_VIDEO_MEDIATEK_JPEG=y
CONFIG_DRM_LIMA=m
CONFIG_COMMON_CLK_MT2701_G3DSYS=y

#Sound
CONFIG_SOUND=y
CONFIG_SND=y #alsa core
CONFIG_SND_SOC=y

#CONFIG_SOUND_OSS_CORE=y
#CONFIG_SOUND_OSS_CORE_PRECLAIM=y
#CONFIG_SND_OSSEMUL=y
#CONFIG_SND_MIXER_OSS=m
#CONFIG_SND_PCM_OSS=m #alsa The PCM OSS emulation module.

#USB/HID
CONFIG_USB=y
CONFIG_USB_XHCI_HCD=y
CONFIG_USB_XHCI_MTK=y
CONFIG_USB_STORAGE=y
CONFIG_USB_SERIAL=y
#CONFIG_NOP_USB_XCEIV=y
#CONFIG_USB_GPIO_VBUS=y
#CONFIG_USB_GADGET=y
#CONFIG_USB_CONFIGFS=y
CONFIG_USB_CONFIGFS_SERIAL=y
#CONFIG_USB_CONFIGFS_ACM=y
#CONFIG_USB_CONFIGFS_OBEX=y
#CONFIG_USB_CONFIGFS_NCM=y
#CONFIG_USB_CONFIGFS_ECM=y
#CONFIG_USB_CONFIGFS_ECM_SUBSET=y
#CONFIG_USB_CONFIGFS_RNDIS=y
#CONFIG_USB_CONFIGFS_EEM=y
CONFIG_USB_CONFIGFS_MASS_STORAGE=y
CONFIG_USB_PRINTER=m

CONFIG_HID=y
CONFIG_HIDRAW=y
#CONFIG_UHID=m
CONFIG_HID_GENERIC=y

CONFIG_USB_HID=y
#CONFIG_HID_PID=y
CONFIG_USB_HIDDEV=y

# CONFIG_USB_OHCI_LITTLE_ENDIAN=y ?
CONFIG_USB_SUPPORT=y
CONFIG_USB_COMMON=y
# CONFIG_USB_ARCH_HAS_HCD=y ?

#additional NET (e.g. tunneling incl. openvpn,vlan-base-support)
CONFIG_TUN=m
#vlan
CONFIG_VLAN_8021Q_GVRP=y
CONFIG_VLAN_8021Q_MVRP=y
CONFIG_NET_L3_MASTER_DEV=y
CONFIG_IPVLAN=m
CONFIG_MACVLAN=m
CONFIG_NET_ACT_VLAN=m
CONFIG_NET_CLS_ACT=y

# QoS and/or fair queueing
CONFIG_NET_SCH_CBQ=m
CONFIG_NET_SCH_HTB=m
CONFIG_NET_SCH_CSZ=m
CONFIG_NET_SCH_PRIO=m
CONFIG_NET_SCH_RED=m
CONFIG_NET_SCH_SFQ=m
CONFIG_NET_SCH_TEQL=m
CONFIG_NET_SCH_TBF=m
CONFIG_NET_SCH_GRED=m
CONFIG_NET_SCH_DSMARK=m
CONFIG_NET_SCH_INGRESS=m
#CONFIG_NET_SCH_NETEM=m
CONFIG_NET_QOS=y
CONFIG_NET_ESTIMATOR=y
CONFIG_NET_CLS_TCINDEX=m
CONFIG_NET_CLS_ROUTE4=m
CONFIG_NET_CLS_ROUTE=y
CONFIG_NET_CLS_FW=m
CONFIG_NET_CLS_U32=m
CONFIG_NET_CLS_RSVP=m
CONFIG_NET_CLS_RSVP6=m
CONFIG_NET_CLS_POLICE=y

#unused drivers which are set by default
CONFIG_WLAN_VENDOR_ADMTEK=n
CONFIG_WLAN_VENDOR_ATH=y
CONFIG_ATH9K=m
CONFIG_ATH10K=m
CONFIG_ATH10K_PCI=m
CONFIG_ATH10K_USB=m
CONFIG_WLAN_VENDOR_ATMEL=n
CONFIG_WLAN_VENDOR_BROADCOM=n
CONFIG_WLAN_VENDOR_CISCO=n
CONFIG_WLAN_VENDOR_INTEL=n
CONFIG_WLAN_VENDOR_INTERSIL=n
CONFIG_WLAN_VENDOR_MARVELL=n
CONFIG_WLAN_VENDOR_REALTEK=n
CONFIG_WLAN_VENDOR_RALINK=n
CONFIG_WLAN_VENDOR_RSI=n
CONFIG_WLAN_VENDOR_ST=n
CONFIG_WLAN_VENDOR_TI=n
CONFIG_WLAN_VENDOR_ZYDAS=n
CONFIG_WLAN_VENDOR_QUANTENNA=n
# CONFIG_ADAPTEC_STARFIRE is not set
# CONFIG_NET_VENDOR_ADAPTEC is not set
# CONFIG_NET_VENDOR_AGERE is not set
# CONFIG_NET_VENDOR_ALACRITECH is not set
# CONFIG_NET_VENDOR_ALTEON is not set
# CONFIG_NET_VENDOR_AMAZON is not set
# CONFIG_NET_VENDOR_AMD is not set
# CONFIG_NET_VENDOR_AQUANTIA is not set
# CONFIG_NET_VENDOR_ARC is not set
# CONFIG_NET_VENDOR_ATHEROS is not set
# CONFIG_NET_VENDOR_AURORA is not set
# CONFIG_NET_CADENCE is not set
# CONFIG_NET_VENDOR_BROADCOM is not set
# CONFIG_NET_VENDOR_BROCADE is not set
# CONFIG_NET_VENDOR_CAVIUM is not set
# CONFIG_NET_VENDOR_CHELSIO is not set
# CONFIG_NET_VENDOR_CIRRUS is not set
# CONFIG_NET_VENDOR_CISCO is not set
# CONFIG_NET_VENDOR_MELLANOX is not set
# CONFIG_NET_VENDOR_MICREL is not set
# CONFIG_NET_VENDOR_MICROCHIP is not set
# CONFIG_NET_VENDOR_MYRI is not set
# CONFIG_NET_VENDOR_NATSEMI is not set
# CONFIG_NET_VENDOR_NETRONOME is not set
# CONFIG_NET_VENDOR_NVIDIA is not set
# CONFIG_NET_VENDOR_OKI is not set
# CONFIG_NET_PACKET_ENGINE is not set
# CONFIG_NET_VENDOR_QLOGIC is not set
# CONFIG_NET_VENDOR_QUALCOMM is not set
# CONFIG_NET_VENDOR_REALTEK is not set
# CONFIG_NET_VENDOR_RENESAS is not set
# CONFIG_NET_VENDOR_RDC is not set
# CONFIG_NET_VENDOR_ROCKER is not set
# CONFIG_NET_VENDOR_SAMSUNG is not set
# CONFIG_NET_VENDOR_SEEQ is not set
# CONFIG_NET_VENDOR_SILAN is not set
# CONFIG_NET_VENDOR_SIS is not set
# CONFIG_NET_VENDOR_SOLARFLARE is not set
# CONFIG_NET_VENDOR_SMSC is not set
# CONFIG_NET_VENDOR_STMICRO is not set
# CONFIG_NET_VENDOR_SUN is not set
# CONFIG_NET_VENDOR_TEHUTI is not set
# CONFIG_NET_VENDOR_TI is not set
# CONFIG_NET_VENDOR_VIA is not set
# CONFIG_NET_VENDOR_WIZNET is not set
# CONFIG_NET_VENDOR_SYNOPSYS is not set
# CONFIG_NET_VENDOR_DEC is not set
# CONFIG_NET_VENDOR_DLINK is not set
# CONFIG_NET_VENDOR_EMULEX is not set
# CONFIG_NET_VENDOR_EZCHIP is not set
# CONFIG_NET_VENDOR_EXAR is not set
# CONFIG_NET_VENDOR_FARADAY is not set
# CONFIG_NET_VENDOR_HISILICON is not set
# CONFIG_NET_VENDOR_HP is not set
# CONFIG_NET_VENDOR_HUAWEI is not set
# CONFIG_NET_VENDOR_INTEL is not set
# CONFIG_NET_VENDOR_MARVELL is not set
# CONFIG_NET_VENDOR_3COM is not set

#NFS Client
CONFIG_NFS_FS=y
CONFIG_NFS_V2=y
CONFIG_NFS_V3_ACL=y
CONFIG_NFS_V4=y
CONFIG_NFS_SWAP=y
CONFIG_NFS_V4_1=y
CONFIG_NFS_V4_2=y
CONFIG_PNFS_FILE_LAYOUT=m
CONFIG_PNFS_BLOCK=m
CONFIG_PNFS_FLEXFILE_LAYOUT=m
CONFIG_NFS_V4_1_IMPLEMENTATION_ID_DOMAIN="kernel.org"
CONFIG_NFS_V4_1_MIGRATION=y
CONFIG_NFS_USE_LEGACY_DNS=y

#NFS Server
CONFIG_NFSD=m
CONFIG_NFSD_V2_ACL=y
CONFIG_NFSD_V3_ACL=y
CONFIG_NFSD_V4=y
CONFIG_NFSD_PNFS=y
CONFIG_NFSD_BLOCKLAYOUT=y
CONFIG_NFSD_SCSILAYOUT=y
CONFIG_NFSD_FLEXFILELAYOUT=y
CONFIG_NFSD_FAULT_INJECTION=y
CONFIG_NFS_ACL_SUPPORT=m

CONFIG_ROOT_NFS=y

#xfs
CONFIG_XFS_FS=m

#RTC/POWER
CONFIG_POWER_RESET=y
CONFIG_POWER_RESET_MT6323=y
CONFIG_POWER_RESET_MT6397_RTC=y

#CONFIG_NET_MEDIATEK_HW_QOS=m
CONFIG_WIREGUARD=m

#CRYPTO
CONFIG_CRYPTO_USER=m
CONFIG_CRYPTO_USER_API_HASH=m
CONFIG_CRYPTO_USER_API_SKCIPHER=m

#usb-tethering
CONFIG_USB_USBNET=m
CONFIG_USB_NET_CDCETHER=m
CONFIG_USB_NET_CDC_EEM=m
#CONFIG_USB_ARMLINUX=y
CONFIG_USB_NET_RNDIS_HOST=m
```
