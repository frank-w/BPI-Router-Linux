## Documentation/devicetree/bindings/arm/mediatek/mediatek,mt7988-ethwarp.yaml
```yaml
# SPDX-License-Identifier: (GPL-2.0 OR BSD-2-Clause)
%YAML 1.2
---
$id: http://devicetree.org/schemas/arm/mediatek/mediatek,mt7988-ethwarp.yaml#
$schema: http://devicetree.org/meta-schemas/core.yaml#

title: MediaTek MT7988 ethwarp Controller

maintainers:
  - Daniel Golle <daniel@makrotopia.org>

description:
  The Mediatek MT7988 ethwarp controller provides clocks and resets for the
  Ethernet related subsystems found the MT7988 SoC.
  The reset-controller can be represented using the ti,syscon-reset bindings.
  The clock values can be found in <dt-bindings/clock/mt*-clk.h>.

properties:
  compatible:
    items:
      - const: mediatek,mt7988-ethwarp
      - const: syscon
      - const: simple-mfd

  reg:
    maxItems: 1

  reset-controller:
    type: object

  '#clock-cells':
    const: 1

required:
  - compatible
  - reg
  - '#clock-cells'

additionalProperties: false

examples:
  - |
    #include <dt-bindings/reset/ti-syscon.h>
    soc {
        #address-cells = <2>;
        #size-cells = <2>;

        clock-controller@15031000 {
            compatible = "mediatek,mt7988-ethwarp", "syscon", "simple-mfd";
            reg = <0 0x15031000 0 0x1000>;
            #clock-cells = <1>;

            reset-controller {
                compatible = "ti,syscon-reset";
                #reset-cells = <1>;
                ti,reset-bits = <
                    0x8 9 0x8 9 0 0 (ASSERT_SET | DEASSERT_CLEAR | STATUS_NONE)
                >;
            };
        };
    };
```

## Documentation/devicetree/bindings/arm/mediatek/mediatek,mt7988-mcusys.yaml
```yaml
# SPDX-License-Identifier: (GPL-2.0 OR BSD-2-Clause)
%YAML 1.2
---
$id: http://devicetree.org/schemas/arm/mediatek/mediatek,mt7988-mcusys.yaml#
$schema: http://devicetree.org/meta-schemas/core.yaml#

title: MediaTek MT7988 MCU System Clock Controller

maintainers:
  - Daniel Golle <daniel@makrotopia.org>

description:
  The Mediatek mcusys controller provides ARM and bus clocks to the system.
  The clock values can be found in <dt-bindings/clock/mt*-clk.h>.

properties:
  compatible:
    items:
      - const: mediatek,mt7988-mcusys
      - const: syscon

  reg:
    maxItems: 1

  '#clock-cells':
    const: 1

required:
  - compatible
  - reg
  - '#clock-cells'

additionalProperties: false

examples:
  - |
    soc {
        #address-cells = <2>;
        #size-cells = <2>;

        clock-controller@100e0000 {
            compatible = "mediatek,mt7988-mcusys", "syscon";
            reg = <0 0x100e0000 0 0x1000>;
            #clock-cells = <1>;
        };
    };
```

## Documentation/devicetree/bindings/arm/mediatek/mediatek,mt7988-xfi-pll.yaml
```yaml
# SPDX-License-Identifier: (GPL-2.0 OR BSD-2-Clause)
%YAML 1.2
---
$id: http://devicetree.org/schemas/arm/mediatek/mediatek,mt7988-xfi-pll.yaml#
$schema: http://devicetree.org/meta-schemas/core.yaml#

title: MediaTek MT7988 XFI PLL Clock Controller

maintainers:
  - Daniel Golle <daniel@makrotopia.org>

description:
  The MediaTek XFI PLL controller provides the 156.25MHz clock for the
  Ethernet SerDes PHY from the 40MHz top_xtal clock.

properties:
  compatible:
    const: mediatek,mt7988-xfi-pll

  reg:
    maxItems: 1

  resets:
    maxItems: 1

  '#clock-cells':
    const: 1

required:
  - compatible
  - reg
  - resets
  - '#clock-cells'

additionalProperties: false

examples:
  - |
    #define MT7988_TOPRGU_XFI_PLL_GRST              16
    soc {
        #address-cells = <2>;
        #size-cells = <2>;
        clock-controller@11f40000 {
            compatible = "mediatek,mt7988-xfi-pll";
            reg = <0 0x11f40000 0 0x1000>;
            resets = <&watchdog MT7988_TOPRGU_XFI_PLL_GRST>;
            #clock-cells = <1>;
        };
    };
```

## Documentation/devicetree/bindings/ata/ahci-platform.yaml
```yaml
# SPDX-License-Identifier: GPL-2.0
%YAML 1.2
---
$id: http://devicetree.org/schemas/ata/ahci-platform.yaml#
$schema: http://devicetree.org/meta-schemas/core.yaml#

title: AHCI SATA Controller
description:
  SATA nodes are defined to describe on-chip Serial ATA controllers.
  Each SATA controller should have its own node.

  It is possible, but not required, to represent each port as a sub-node.
  It allows to enable each port independently when dealing with multiple
  PHYs.

maintainers:
  - Hans de Goede <hdegoede@redhat.com>
  - Jens Axboe <axboe@kernel.dk>

properties:
  compatible:
    enum:
      - brcm,iproc-ahci
      - hisilicon,hisi-ahci
      - cavium,octeon-7130-ahci
      - ibm,476gtr-ahci
      - marvell,armada-380-ahci
      - marvell,armada-3700-ahci
      - snps,dwc-ahci
      - snps,spear-ahci
      - generic-ahci

  ahci-supply:
    description:
      regulator for AHCI controller

  dma-coherent:
    description:
      Present if dma operations are coherent

  clocks:
    minItems: 1
    maxItems: 3

  interrupts:
    minItems: 1

  phy-supply:
    description:
      regulator for PHY power

  phys:
    minItems: 1

  phy-names:
    minItems: 1

  ports-implemented:
    description:
      Mask that indicates which ports that the HBA supports
      are available for software to use. Useful if PORTS_IMPL
      is not programmed by the BIOS, which is true with
      some embedded SOC's.
    minItems: 1

  reg:
    maxItems: 1

  resets:
    minItems: 1

  target-supply:
    description:
      regulator for SATA target power

required:
  - compatible
  - reg
  - interrupts

patternProperties:
  "^sata-port@[0-9]+$":
    type: object
    description:
      Subnode with configuration of the Ports.

    properties:
      reg:
        maxItems: 1

      phys:
        minItems: 1

      target-supply:
        description:
          regulator for SATA target power

    required:
      - reg

    anyOf:
      - required: [ phys ]
      - required: [ target-supply ]

additionalProperties: true

examples:
  - |
        sata@ffe08000 {
               compatible = "snps,spear-ahci";
               reg = <0xffe08000 0x1000>;
               interrupts = <115>;
        };
  - |
        sata@f7e90000 {
                compatible = "marvell,berlin2q-achi", "generic-ahci";
                reg = <0xe90000 0x1000>;
                interrupts = <GIC_SPI 7 IRQ_TYPE_LEVEL_HIGH>;
                clocks = <&chip CLKID_SATA>;
                #address-cells = <1>;
                #size-cells = <0>;

                sata0: sata-port@0 {
                        reg = <0>;
                        phys = <&sata_phy 0>;
                        target-supply = <&reg_sata0>;
                };

                sata1: sata-port@1 {
                        reg = <1>;
                        phys = <&sata_phy 1>;
                        target-supply = <&reg_sata1>;;
                };
        };
```

## Documentation/devicetree/bindings/block/block-device.yaml
```yaml
# SPDX-License-Identifier: GPL-2.0-only OR BSD-2-Clause
%YAML 1.2
---
$id: http://devicetree.org/schemas/block/block-device.yaml#
$schema: http://devicetree.org/meta-schemas/core.yaml#

title: block storage device

description: |
  This binding is generic and describes a block-oriented storage device.

maintainers:
  - Daniel Golle <daniel@makrotopia.org>

properties:
  compatible:
    contains:
      const: block-device

  partitions:
    $ref: /schemas/block/partitions.yaml

required:
  - compatible

# This is a generic file other binding inherit from and extend
additionalProperties: true
```

## Documentation/devicetree/bindings/block/partition.yaml
```yaml
# SPDX-License-Identifier: GPL-2.0-only OR BSD-2-Clause
%YAML 1.2
---
$id: http://devicetree.org/schemas/block/partition.yaml#
$schema: http://devicetree.org/meta-schemas/core.yaml#

title: Partition on a block device

description: |
  This binding describes a partition on a block device.
  Partitions may be matched by a combination of partition number, name,
  and UUID.

maintainers:
  - Daniel Golle <daniel@makrotopia.org>

properties:
  $nodename:
    pattern: '^block-partition-.+$'

  partnum:
    description:
      Matches partition by number if present.

  partname:
    "$ref": "/schemas/types.yaml#/definitions/string"
    description:
      Matches partition by PARTNAME if present.

  uuid:
    "$ref": "/schemas/types.yaml#/definitions/string"
    description:
      Matches partition by PARTUUID if present.

anyOf:
  - required:
    - partnum

  - required:
    - partname

  - required:
    - uuid

# This is a generic file other binding inherit from and extend
additionalProperties: true
```

## Documentation/devicetree/bindings/net/airoha,en8811h.yaml
```yaml
# SPDX-License-Identifier: (GPL-2.0-only OR BSD-2-Clause)
%YAML 1.2
---
$id: http://devicetree.org/schemas/net/airoha,en8811h.yaml#
$schema: http://devicetree.org/meta-schemas/core.yaml#

title: Airoha EN8811H PHY

maintainers:
  - Someone <someone@somemail.com>

description:
  Bindings for Airoha EN8811H PHY

allOf:
  - $ref: ethernet-phy.yaml#

properties:
  airoha,pnswap-rx:
    type: boolean
    description:
      Reverse rx polarity of the SERDES. This is the receiving
      side of the lines from the MAC towards the EN881H.


  airoha,pnswap-tx:
    type: boolean
    description:
      Reverse tx polarity of SERDES. This is the transmitting
      side of the lines from EN8811H towards the MAC.

unevaluatedProperties: false

examples:
  - |
    mdio {
        #address-cells = <1>;
        #size-cells = <0>;

        ethphy1: ethernet-phy@1 {
                reg = <1>;
                airoha,pnswap-rx;
        };
    };
```

## Documentation/devicetree/bindings/net/pcs/mediatek,usxgmii.yaml
```yaml
# SPDX-License-Identifier: (GPL-2.0 OR BSD-2-Clause)
%YAML 1.2
---
$id: http://devicetree.org/schemas/net/pcs/mediatek,usxgmii.yaml#
$schema: http://devicetree.org/meta-schemas/core.yaml#

title: MediaTek USXGMII PCS

maintainers:
  - Daniel Golle <daniel@makrotopia.org>

description:
  The MediaTek USXGMII PCS provides physical link control and status
  for USXGMII, 10GBase-R and 5GBase-R links on the SerDes interfaces
  provided by the PEXTP PHY.
  In order to also support legacy 2500Base-X, 1000Base-X and Cisco
  SGMII an existing mediatek,*-sgmiisys LynxI PCS is wrapped to
  provide those interfaces modes on the same SerDes interfaces shared
  with the USXGMII PCS.

properties:
  $nodename:
    pattern: "^pcs@[0-9a-f]+$"

  compatible:
    const: mediatek,mt7988-usxgmiisys

  reg:
    maxItems: 1

  clocks:
    items:
      - description: USXGMII top-level clock
      - description: SGMII top-level clock
      - description: SGMII subsystem TX clock
      - description: SGMII subsystem RX clock
      - description: XFI PLL clock

  clock-names:
    items:
      - const: usxgmii
      - const: sgmii_sel
      - const: sgmii_tx
      - const: sgmii_rx
      - const: xfi_pll

  phys:
    items:
      - description: PEXTP SerDes PHY

  mediatek,sgmiisys:
    $ref: /schemas/types.yaml#/definitions/phandle
    description:
      Phandle to the syscon node of the corresponding SGMII LynxI PCS.

  resets:
    items:
      - description: XFI reset
      - description: SGMII reset

  reset-names:
    items:
      - const: xfi
      - const: sgmii

required:
  - compatible
  - reg
  - clocks
  - clock-names
  - phys
  - mediatek,sgmiisys
  - resets
  - reset-names

additionalProperties: false

examples:
  - |
    #include <dt-bindings/clock/mediatek,mt7988-clk.h>
    #include <dt-bindings/reset/mediatek,mt7988-resets.h>
    soc {
      #address-cells = <2>;
      #size-cells = <2>;
        usxgmiisys0: pcs@10080000 {
          compatible = "mediatek,mt7988-usxgmiisys";
          reg = <0 0x10080000 0 0x1000>;
          clocks = <&topckgen CLK_TOP_USXGMII_SBUS_0_SEL>,
                   <&topckgen CLK_TOP_SGM_0_SEL>,
                   <&sgmiisys0 CLK_SGM0_TX_EN>,
                   <&sgmiisys0 CLK_SGM0_RX_EN>,
                   <&xfi_pll CLK_XFIPLL_PLL_EN>;
          clock-names = "usxgmii", "sgmii_sel", "sgmii_tx", "sgmii_rx", "xfi_pll";
          resets = <&watchdog MT7988_TOPRGU_XFI0_GRST>,
                   <&watchdog MT7988_TOPRGU_SGMII0_GRST>;
          reset-names = "xfi", "sgmii";
          phys = <&xfi_pextp0>;
          mediatek,sgmiisys = <&sgmiisys0>;
        };
    };
```

## Documentation/devicetree/bindings/pci/mediatek-pcie-cfg.yaml
```yaml
# SPDX-License-Identifier: GPL-2.0-only OR BSD-2-Clause
%YAML 1.2
---
$id: http://devicetree.org/schemas/pci/mediatek-pcie-cfg.yaml#
$schema: http://devicetree.org/meta-schemas/core.yaml#

title: Mediatek PCIECFG controller

maintainers:
  - Chuanjia Liu <chuanjia.liu@mediatek.com>
  - Jianjun Wang <jianjun.wang@mediatek.com>

description: |
  The MediaTek PCIECFG controller controls some feature about
  LTSSM, ASPM and so on.

properties:
  compatible:
      items:
        - enum:
            - mediatek,mt7622-pciecfg
            - mediatek,mt7629-pciecfg
        - const: syscon

  reg:
    maxItems: 1

required:
  - compatible
  - reg

examples:
  - |
    pciecfg: pciecfg@1a140000 {
        compatible = "mediatek,mt7622-pciecfg", "syscon";
        reg = <0 0x1a140000 0 0x1000>;
    };
...
```

## Documentation/devicetree/bindings/phy/mediatek,xfi-pextp.yaml
```yaml
# SPDX-License-Identifier: (GPL-2.0-only OR BSD-2-Clause)
%YAML 1.2
---
$id: http://devicetree.org/schemas/phy/mediatek,xfi-pextp.yaml#
$schema: http://devicetree.org/meta-schemas/core.yaml#

title: MediaTek XFI PEXTP SerDes PHY

maintainers:
  - Daniel Golle <daniel@makrotopia.org>

description:
  The MediaTek XFI PEXTP SerDes PHY provides the physical SerDes lanes
  used by the MediaTek USXGMII PCS.

properties:
  $nodename:
    pattern: "^phy@[0-9a-f]+$"

  compatible:
    const: mediatek,mt7988-xfi-pextp

  reg:
    maxItems: 1

  clocks:
    items:
      - description: XFI PHY clock

  resets:
    items:
      - description: PEXTP reset

  mediatek,usxgmii-performance-errata:
    $ref: /schemas/types.yaml#/definitions/flag
    description:
      USXGMII0 on MT7988 suffers from a performance problem in 10GBase-R
      mode which needs a work-around in the driver. The work-around is
      enabled using this flag.

  "#phy-cells":
    const: 0

required:
  - compatible
  - reg
  - clocks
  - resets
  - "#phy-cells"

additionalProperties: false

examples:
  - |
    #include <dt-bindings/clock/mediatek,mt7988-clk.h>
    #include <dt-bindings/reset/mediatek,mt7988-resets.h>
    soc {
      #address-cells = <2>;
      #size-cells = <2>;

      phy@11f20000 {
        compatible = "mediatek,mt7988-xfi-pextp";
        reg = <0 0x11f20000 0 0x10000>;
        clocks = <&topckgen CLK_TOP_XFI_PHY_0_XTAL_SEL>;
        resets = <&watchdog MT7988_TOPRGU_XFI_PEXTP0_GRST>;
        mediatek,usxgmii-performance-errata;
        #phy-cells = <0>;
      };
    };

...
```
