## bpi-r4.its
```
/dts-v1/;

/ {
	description = "U-Boot fitImage for bpi-r4 aarch64 kernel";
	#address-cells = <1>;

	images {
		kernel-1 {
			description = "Linux Kernel %version%";
			data = /incbin/("./arch/arm64/boot/Image.gz");
			type = "kernel";
			arch = "arm64";
			os = "linux";
			compression = "gzip";
			load = <0x44000000>;
			entry = <0x44000000>;
			hash-1 {
				algo = "sha1";
			};
		};
		fdt-base {
			description = "Flattened Device Tree blob BPI-R4 dual SFP+";
			data = /incbin/("./arch/arm64/boot/dts/mediatek/mt7988a-bananapi-bpi-r4.dtb");
			type = "flat_dt";
			arch = "arm64";
			load = <0x47000000>;
			compression = "none";
			hash-1 {
				algo = "sha1";
			};
		};
		fdt-base-2g5 {
			description = "Flattened Device Tree blob BPI-R4 2.5G";
			data = /incbin/("./arch/arm64/boot/dts/mediatek/mt7988a-bananapi-bpi-r4-2g5.dtb");
			type = "flat_dt";
			arch = "arm64";
			load = <0x47000000>;
			compression = "none";
			hash-1 {
				algo = "sha1";
			};
		};
		fdt-base-r4pro-4e {
			description = "Flattened Device Tree blob BPI-R4 Pro 4E";
			data = /incbin/("./arch/arm64/boot/dts/mediatek/mt7988a-bananapi-bpi-r4-pro-4e.dtb");
			type = "flat_dt";
			arch = "arm64";
			load = <0x47000000>;
			compression = "none";
			hash-1 {
				algo = "sha1";
			};
		};
		fdt-base-r4pro-8x {
			description = "Flattened Device Tree blob BPI-R4 Pro 8X";
			data = /incbin/("./arch/arm64/boot/dts/mediatek/mt7988a-bananapi-bpi-r4-pro-8x.dtb");
			type = "flat_dt";
			arch = "arm64";
			load = <0x47000000>;
			compression = "none";
			hash-1 {
				algo = "sha1";
			};
		};
		fdt-base-lite {
			description = "Flattened Device Tree blob BPI-R4 Lite";
			data = /incbin/("./arch/arm64/boot/dts/mediatek/mt7987a-bananapi-bpi-r4-lite.dtb");
			type = "flat_dt";
			arch = "arm64";
			load = <0x47000000>;
			compression = "none";
			hash-1 {
				algo = "sha1";
			};
		};
		fdt-ov-sd {
			description = "Flattened Device Tree blob";
			data = /incbin/("./arch/arm64/boot/dts/mediatek/mt7988a-bananapi-bpi-r4-sd.dtbo");
			type = "flat_dt";
		};
		fdt-ov-emmc {
			description = "Flattened Device Tree blob";
			data = /incbin/("./arch/arm64/boot/dts/mediatek/mt7988a-bananapi-bpi-r4-emmc.dtbo");
			type = "flat_dt";
		};
		fdt-ov-be14 {
			description = "DT overlay for BE14 wifi card eeprom";
			data = /incbin/("./arch/arm64/boot/dts/mediatek/mt7988a-bananapi-bpi-r4-wifi-be14.dtbo");
			type = "flat_dt";
		};
		fdt-ov-nand {
			description = "DT overlay for NAND size on 8G boards";
			data = /incbin/("./arch/arm64/boot/dts/mediatek/mt7988a-bananapi-bpi-r4-nand.dtbo");
			type = "flat_dt";
		};
		fdt-ov-lite-sd {
			description = "Flattened Device Tree blob";
			data = /incbin/("./arch/arm64/boot/dts/mediatek/mt7987a-bananapi-bpi-r4-lite-sd.dtbo");
			type = "flat_dt";
		};
		fdt-ov-lite-emmc {
			description = "Flattened Device Tree blob";
			data = /incbin/("./arch/arm64/boot/dts/mediatek/mt7987a-bananapi-bpi-r4-lite-emmc.dtbo");
			type = "flat_dt";
		};
		fdt-ov-lite-nand {
			description = "Flattened Device Tree blob";
			data = /incbin/("./arch/arm64/boot/dts/mediatek/mt7987a-bananapi-bpi-r4-lite-nand.dtbo");
			type = "flat_dt";
		};
		fdt-ov-lite-nor {
			description = "Flattened Device Tree blob";
			data = /incbin/("./arch/arm64/boot/dts/mediatek/mt7987a-bananapi-bpi-r4-lite-nor.dtbo");
			type = "flat_dt";
		};
		fdt-ov-lite-1pcie {
			description = "DT overlay for R4Lite 1 pcie 2 Lanes";
			data = /incbin/("./arch/arm64/boot/dts/mediatek/mt7987a-bananapi-bpi-r4-lite-1pcie-2L.dtbo");
			type = "flat_dt";
		};
		fdt-ov-lite-2pcie {
			description = "DT overlay for R4Lite 2 pcie a 1 Lanes";
			data = /incbin/("./arch/arm64/boot/dts/mediatek/mt7987a-bananapi-bpi-r4-lite-2pcie-1L.dtbo");
			type = "flat_dt";
		};
		fdt-ov-pro-cn13 {
			description = "DT overlay for R4Pro CN13";
			data = /incbin/("./arch/arm64/boot/dts/mediatek/mt7988a-bananapi-bpi-r4-pro-cn13.dtbo");
			type = "flat_dt";
		};
		fdt-ov-pro-cn14 {
			description = "DT overlay for R4Pro CN14";
			data = /incbin/("./arch/arm64/boot/dts/mediatek/mt7988a-bananapi-bpi-r4-pro-cn14.dtbo");
			type = "flat_dt";
		};
		fdt-ov-pro-cn15 {
			description = "DT overlay for R4Pro CN15";
			data = /incbin/("./arch/arm64/boot/dts/mediatek/mt7988a-bananapi-bpi-r4-pro-cn15.dtbo");
			type = "flat_dt";
		};
		fdt-ov-pro-cn18 {
			description = "DT overlay for R4Pro CN18";
			data = /incbin/("./arch/arm64/boot/dts/mediatek/mt7988a-bananapi-bpi-r4-pro-cn18.dtbo");
			type = "flat_dt";
		};
		fdt-ov-pro-sd {
			description = "DT overlay for R4Pro SD";
			data = /incbin/("./arch/arm64/boot/dts/mediatek/mt7988a-bananapi-bpi-r4-pro-sd.dtbo");
			type = "flat_dt";
		};
		fdt-ov-pro-emmc {
			description = "DT overlay for R4Pro EMMC";
			data = /incbin/("./arch/arm64/boot/dts/mediatek/mt7988a-bananapi-bpi-r4-pro-emmc.dtbo");
			type = "flat_dt";
		};

		fdt-ov-pro-4e-wan-phy {
			description = "DT overlay for R4Pro 4E WAN-PHY";
			data = /incbin/("./arch/arm64/boot/dts/mediatek/mt7988a-bananapi-bpi-r4-pro-4e-wan-2g5.dtbo");
			type = "flat_dt";
		};
		fdt-ov-pro-4e-wan-sfp {
			description = "DT overlay for R4Pro 4E WAN-SFP";
			data = /incbin/("./arch/arm64/boot/dts/mediatek/mt7988a-bananapi-bpi-r4-pro-4e-wan-sfp.dtbo");
			type = "flat_dt";
		};

		fdt-ov-pro-8x-lan-phy {
			description = "DT overlay for R4Pro LAN-PHY";
			data = /incbin/("./arch/arm64/boot/dts/mediatek/mt7988a-bananapi-bpi-r4-pro-8x-lan-phy.dtbo");
			type = "flat_dt";
		};
		fdt-ov-pro-8x-lan-sfp {
			description = "DT overlay for R4Pro LAN-SFP";
			data = /incbin/("./arch/arm64/boot/dts/mediatek/mt7988a-bananapi-bpi-r4-pro-8x-lan-sfp.dtbo");
			type = "flat_dt";
		};
		fdt-ov-pro-8x-wan-phy {
			description = "DT overlay for R4Pro WAN-PHY";
			data = /incbin/("./arch/arm64/boot/dts/mediatek/mt7988a-bananapi-bpi-r4-pro-8x-wan-phy.dtbo");
			type = "flat_dt";
		};
		fdt-ov-pro-8x-wan-sfp {
			description = "DT overlay for R4Pro WAN-SFP";
			data = /incbin/("./arch/arm64/boot/dts/mediatek/mt7988a-bananapi-bpi-r4-pro-8x-wan-sfp.dtbo");
			type = "flat_dt";
		};
/*		ramdisk-1 {
			description = "ramdisk";
			data = /incbin/("./rootfs_arm64.cpio.gz");
			type = "ramdisk";
			arch = "arm64";
			os = "linux";
			compression = "gzip";
			hash-1 {
				algo = "sha1";
			};
		};*/
	};
	configurations {
		default = "conf-sd";
		conf-base {
			description = "Boot Linux kernel with base FDT blob for BPI-R4 dual SFP+";
			kernel = "kernel-1";
			fdt = "fdt-base";
			//ramdisk = "ramdisk-1";
			hash-1 {
				algo = "sha1";
			};
		};
		conf-base-2g5 {
			description = "Boot Linux kernel with base FDT blob for BPI-R4 2.5G";
			kernel = "kernel-1";
			fdt = "fdt-base-2g5";
			//ramdisk = "ramdisk-1";
			hash-1 {
				algo = "sha1";
			};
		};
		conf-base-r4pro {
			description = "Boot Linux kernel with base FDT blob for BPI-R4 Pro";
			kernel = "kernel-1";
			fdt = "fdt-base-r4pro-8x";
			//ramdisk = "ramdisk-1";
			hash-1 {
				algo = "sha1";
			};
		};
		conf-base-r4pro-4e {
			description = "Boot Linux kernel with base FDT blob for BPI-R4 Pro 4E";
			kernel = "kernel-1";
			fdt = "fdt-base-r4pro-4e";
			//ramdisk = "ramdisk-1";
			hash-1 {
				algo = "sha1";
			};
		};
		conf-base-r4pro-8x {
			description = "Boot Linux kernel with base FDT blob for BPI-R4 Pro 8X";
			kernel = "kernel-1";
			fdt = "fdt-base-r4pro-8x";
			//ramdisk = "ramdisk-1";
			hash-1 {
				algo = "sha1";
			};
		};
		conf-base-r4lite {
			description = "Boot Linux kernel with base FDT blob for BPI-R4 Lite";
			kernel = "kernel-1";
			fdt = "fdt-base-lite";
			//ramdisk = "ramdisk-1";
			hash-1 {
				algo = "sha1";
			};
		};
		conf-sd {
			description = "Boot Linux kernel with SD FDT blob";
			kernel = "kernel-1";
			fdt = "fdt-base", "fdt-ov-sd";
			//ramdisk = "ramdisk-1";
			hash-1 {
				algo = "sha1";
			};
		};
		conf-emmc {
			description = "Boot Linux kernel with EMMC FDT blob";
			kernel = "kernel-1";
			fdt = "fdt-base", "fdt-ov-emmc";
			//ramdisk = "ramdisk-1";
			hash-1 {
				algo = "sha1";
			};
		};
		ov-sd {
			description = "SD FDT overlay blob for R4";
			fdt = "fdt-ov-sd";
		};
		ov-emmc {
			description = "EMMC FDT overlay blob for R4";
			fdt = "fdt-ov-emmc";
		};
		ov-be14 {
			description = "BE14 FDT overlay blob for R4";
			fdt = "fdt-ov-be14";
		};
		ov-nand {
			description = "NAND FDT overlay blob for R4";
			fdt = "fdt-ov-nand";
		};
		ov-lite-sd {
			description = "SD FDT overlay blob for R4 Lite";
			fdt = "fdt-ov-lite-sd";
		};
		ov-lite-emmc {
			description = "EMMC FDT overlay blob for R4 Lite";
			fdt = "fdt-ov-lite-emmc";
		};
		ov-lite-nand {
			description = "NAND FDT overlay blob for R4 Lite";
			fdt = "fdt-ov-lite-nand";
		};
		ov-lite-nor {
			description = "NOR FDT overlay blob for R4 Lite";
			fdt = "fdt-ov-lite-nor";
		};
		ov-lite-1pcie2l {
			description = "1 PCIe 2Lane FDT overlay blob for R4 Lite";
			fdt = "fdt-ov-lite-1pcie";
		};
		ov-lite-2pcie1l {
			description = "2 PCIe 1Lane FDT overlay blob for R4 Lite";
			fdt = "fdt-ov-lite-2pcie";
		};
		ov-pro-sd {
			description = "SD FDT overlay blob for R4 Pro";
			fdt = "fdt-ov-pro-sd";
		};
		ov-pro-emmc {
			description = "EMMC FDT overlay blob for R4 Pro";
			fdt = "fdt-ov-pro-emmc";
		};
		ov-pro-cn13 {
			description = "CN15 FDT overlay blob for R4 Pro";
			fdt = "fdt-ov-pro-cn13";
		};
		ov-pro-cn14 {
			description = "CN18 FDT overlay blob for R4 Pro";
			fdt = "fdt-ov-pro-cn14";
		};
		ov-pro-cn15 {
			description = "CN15 FDT overlay blob for R4 Pro";
			fdt = "fdt-ov-pro-cn15";
		};
		ov-pro-cn18 {
			description = "CN18 FDT overlay blob for R4 Pro";
			fdt = "fdt-ov-pro-cn18";
		};
		ov-pro-4e-wan-phy {
			description = "WAN-PHY FDT overlay blob for R4 Pro 4E";
			fdt = "fdt-ov-pro-4e-wan-phy";
		};
		ov-pro-4e-wan-sfp {
			description = "WAN-SFP FDT overlay blob for R4 Pro 4E";
			fdt = "fdt-ov-pro-4e-wan-sfp";
		};
		//setenv addconf "#ov-pro-8x-lan-phy#ov-pro-8x-wan-phy"
		ov-pro-8x-lan-phy {
			description = "LAN-PHY FDT overlay blob for R4 Pro 8X";
			fdt = "fdt-ov-pro-8x-lan-phy";
		};
		ov-pro-8x-lan-sfp {
			description = "LAN-SFP FDT overlay blob for R4 Pro 8X";
			fdt = "fdt-ov-pro-8x-lan-sfp";
		};
		ov-pro-8x-wan-phy {
			description = "WAN-PHY FDT overlay blob for R4 Pro 8X";
			fdt = "fdt-ov-pro-8x-wan-phy";
		};
		ov-pro-8x-wan-sfp {
			description = "WAN-SFP FDT overlay blob for R4 Pro 8X";
			fdt = "fdt-ov-pro-8x-wan-sfp";
		};
	};
};
```

## drivers/net/dsa/mxl862xx_downstream/Kconfig
```kconfig
# SPDX-License-Identifier: GPL-2.0-only
config NET_DSA_MXL862_DS
	tristate "MaxLinear MxL862xx downstream driver"
	depends on NET_DSA
	#select NET_DSA_TAG_MXL862
	select NET_DSA_TAG_MXL_862XX
	help
	  This enables support for the MaxLinear MxL862xx switch family (downstream).
```

## drivers/net/pcs/airoha/Kconfig
```kconfig
# SPDX-License-Identifier: GPL-2.0-only

config PCS_AIROHA
	tristate
	select FWNODE_PCS

config PCS_AIROHA_AN7581
	tristate "Airoha AN7581 PCS driver"
	depends on ARCH_AIROHA || COMPILE_TEST
	select PCS_AIROHA
	help
	  This module provides helper to phylink for managing the Airoha
	  AN7581 PCS for SoC Ethernet and PON SERDES.
```

## drivers/net/phy/as21xx_1.9.2/Kconfig
```kconfig
config AS21XXX_PHY_192
	tristate "Aeonsemi AS21xxx PHYs v1.9.2"
	depends on !AS21XXX_PHY
	help
	  Currently supports the Aeonsemi AS21xxx PHY.

	  These are C45 PHYs 10G that require all a generic firmware.

	  Supported PHYs AS21011JB1, AS21011PB1, AS21010JB1, AS21010PB1,
	  AS21511JB1, AS21511PB1, AS21510JB1, AS21510PB1, AS21210JB1,
	  AS21210PB1 that all register with the PHY ID 0x7500 0x7500
	  before the firmware is loaded.

config CONFIG_AS21XXX_DEBUGFS
	tristate "Aeonsemi AS21xxx DEBUG-FS"
	depends on AS21XXX_PHY_192
	help
	  Debugfs entries for Aeonsemi AS21xxx PHY.
```
