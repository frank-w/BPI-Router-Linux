## Documentation/devicetree/bindings/mtd/partitions/ubi-volume.yaml
```yaml
# SPDX-License-Identifier: GPL-2.0-only OR BSD-2-Clause
%YAML 1.2
---
$id: http://devicetree.org/schemas/mtd/partitions/ubi-volume.yaml#
$schema: http://devicetree.org/meta-schemas/core.yaml#

title: UBI volume

description: |
  This binding describes a single UBI volume. Volumes can be matches either
  by their ID or their name, or both.

maintainers:
  - Daniel Golle <daniel@makrotopia.org>

properties:
  volid:
    $ref: /schemas/types.yaml#/definitions/uint32
    description:
      Match UBI volume ID

  volname:
    $ref: /schemas/types.yaml#/definitions/string
    description:
      Match UBI volume ID

  nvmem-layout:
    $ref: /schemas/nvmem/layouts/nvmem-layout.yaml#
    description:
      This container may reference an NVMEM layout parser.

  volume-is-critical:
    description: This parameter, if present, indicates that the UBI volume
      contains early-boot firmware images or data which should not be clobbered.
      If set, it prevents the user from renaming the volume, writing to it or
      making any changes affecting it, as well as detaching the UBI device it is
      located on, so direct access to the underlying MTD device is prevented as
      well.
    type: boolean

anyOf:
  - required:
      - volid

  - required:
      - volname

# This is a generic file other binding inherit from and extend
additionalProperties: true
```

## Documentation/devicetree/bindings/net/pcs/airoha,pcs.yaml
```yaml
# SPDX-License-Identifier: GPL-2.0-only OR BSD-2-Clause
%YAML 1.2
---
$id: http://devicetree.org/schemas/net/pcs/airoha,pcs.yaml#
$schema: http://devicetree.org/meta-schemas/core.yaml#

title: Airoha Ethernet PCS and Serdes

maintainers:
  - Christian Marangi <ansuelsmth@gmail.com>

description:
  Airoha AN7581 SoC expose multiple Physical Coding Sublayer (PCS) for
  the various Serdes port supporting different Media Independent Interface
  (10BASE-R, USXGMII, 2500BASE-X, 1000BASE-X, SGMII).

properties:
  compatible:
    enum:
      - airoha,an7581-pcs-eth
      - airoha,an7581-pcs-pon
      - airoha,an7581-pcs-pcie
      - airoha,an7581-pcs-usb

  reg:
    minItems: 6
    maxItems: 15

  reg-names:
    minItems: 6
    maxItems: 15

  airoha,scu:
    $ref: /schemas/types.yaml#/definitions/phandle
    description: phandle to the SCU node required to configure
      the serdes line to the correct interface mode.

  phys:
    maxItems: 1

  "#pcs-cells": true

required:
  - compatible
  - reg
  - reg-names
  - "#pcs-cells"

allOf:
  - if:
      properties:
        compatible:
          contains:
            enum:
              - airoha,an7581-pcs-eth
              - airoha,an7581-pcs-pon

    then:
      properties:
        reg:
          items:
            - description: PCS MAC reg
            - description: HSGMII AN reg
            - description: HSGMII PCS reg
            - description: MULTI SGMII reg
            - description: USXGMII reg
            - description: HSGMII rate adaption reg
            - description: PCS Analog register
            - description: PCS PMA (Physical Medium Attachment) register

        reg-names:
          items:
            - const: pcs_mac
            - const: hsgmii_an
            - const: hsgmii_pcs
            - const: multi_sgmii
            - const: usxgmii
            - const: hsgmii_rate_adp
            - const: pcs_ana
            - const: pcs_pma

        phys: false

        "#pcs-cells":
          const: 0

      required:
        - airoha,scu

  - if:
      properties:
        compatible:
          contains:
            const: airoha,an7581-pcs-pcie

    then:
      properties:
        reg:
          items:
            - description: PCS MAC 0 reg
            - description: HSGMII AN 0 reg
            - description: HSGMII PCS 0 reg
            - description: MULTI SGMII 0 reg
            - description: USXGMII 0 reg
            - description: HSGMII rate adaption 0 reg
            - description: PCS MAC 1 reg
            - description: HSGMII AN 1 reg
            - description: HSGMII PCS 1 reg
            - description: MULTI SGMII 1 reg
            - description: USXGMII 1 reg
            - description: HSGMII rate adaption 1 reg
            - description: PCS Analog register
            - description: PCS PMA (Physical Medium Attachment) 0 register
            - description: PCS PMA (Physical Medium Attachment) 1 register

        reg-names:
          items:
            - const: pcs_mac0
            - const: hsgmii_an0
            - const: hsgmii_pcs0
            - const: multi_sgmii0
            - const: usxgmii0
            - const: hsgmii_rate_adp0
            - const: pcs_mac1
            - const: hsgmii_an1
            - const: hsgmii_pcs1
            - const: multi_sgmii1
            - const: usxgmii1
            - const: hsgmii_rate_adp1
            - const: pcs_ana
            - const: pcs_pma0
            - const: pcs_pma1

        phys: false

        "#pcs-cells":
          const: 1

      required:
        - airoha,scu

  - if:
      properties:
        compatible:
          contains:
            const: airoha,an7581-pcs-usb

    then:
      properties:
        reg:
          items:
            - description: PCS MAC reg
            - description: HSGMII AN reg
            - description: HSGMII PCS reg
            - description: MULTI SGMII reg
            - description: HSGMII rate adaption reg
            - description: PCS Analog register

        reg-names:
          items:
            - const: pcs_mac
            - const: hsgmii_an
            - const: hsgmii_pcs
            - const: multi_sgmii
            - const: hsgmii_rate_adp
            - const: pcs_ana

        airoha,scu: false

        "#pcs-cells":
          const: 0

      required:
        - phys

additionalProperties: false

examples:
  - |
    #include <dt-bindings/phy/phy.h>

    pcs@1fa08000 {
      compatible = "airoha,an7581-pcs-pon";
      reg = <0x1fa08000 0x1000>,
            <0x1fa80000 0x60>,
            <0x1fa80a00 0x164>,
            <0x1fa84000 0x450>,
            <0x1fa85900 0x338>,
            <0x1fa86000 0x300>,
            <0x1fa8a000 0x1000>,
            <0x1fa8b000 0x1000>;
      reg-names = "pcs_mac", "hsgmii_an", "hsgmii_pcs",
                  "multi_sgmii", "usxgmii",
                  "hsgmii_rate_adp", "pcs_ana", "pcs_pma";

      airoha,scu = <&scuclk>;
      #pcs-cells = <0>;
    };

    pcs@1fa09000 {
      compatible = "airoha,an7581-pcs-eth";
      reg = <0x1fa09000 0x1000>,
            <0x1fa70000 0x60>,
            <0x1fa70a00 0x164>,
            <0x1fa74000 0x450>,
            <0x1fa75900 0x338>,
            <0x1fa76000 0x300>,
            <0x1fa7a000 0x1000>,
            <0x1fa7b000 0x1000>;
      reg-names = "pcs_mac", "hsgmii_an", "hsgmii_pcs",
                  "multi_sgmii", "usxgmii",
                  "hsgmii_rate_adp", "pcs_ana", "pcs_pma";

      airoha,scu = <&scuclk>;
      #pcs-cells = <0>;
    };

    pcs@1fa04000 {
      compatible = "airoha,an7581-pcs-pcie";
      reg = <0x1fa04000 0x1000>,
            <0x1fa50000 0x60>,
            <0x1fa50a00 0x164>,
            <0x1fa54000 0x450>,
            <0x1fa55900 0x338>,
            <0x1fa56000 0x300>,
            <0x1fa05000 0x1000>,
            <0x1fa60000 0x60>,
            <0x1fa60a00 0x164>,
            <0x1fa64000 0x450>,
            <0x1fa65900 0x338>,
            <0x1fa66000 0x300>,
            <0x1fa5a000 0x1000>,
            <0x1fa5b000 0x1000>,
            <0x1fa5c000 0x1000>;
      reg-names = "pcs_mac0", "hsgmii_an0", "hsgmii_pcs0",
                  "multi_sgmii0", "usxgmii0",
                  "hsgmii_rate_adp0",
                  "pcs_mac1", "hsgmii_an1", "hsgmii_pcs1",
                  "multi_sgmii1", "usxgmii1",
                  "hsgmii_rate_adp1",
                  "pcs_ana", "pcs_pma0", "pcs_pma1";

      airoha,scu = <&scuclk>;
      #pcs-cells = <1>;
    };

    pcs@1fa07000 {
      compatible = "airoha,an7581-pcs-usb";
      reg = <0x1fa07000 0x1000>,
            <0x1fa90000 0x60>,
            <0x1fa90a00 0x164>,
            <0x1fa94000 0x450>,
            <0x1fa96000 0x300>,
            <0x1fa9a000 0x600>;
      reg-names = "pcs_mac", "hsgmii_an", "hsgmii_pcs",
                  "multi_sgmii", "hsgmii_rate_adp","pcs_ana";

      phys = <&usb0_phy PHY_TYPE_USB3>;

      #pcs-cells = <0>;
    };
```
