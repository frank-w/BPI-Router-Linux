## drivers/net/pcs/airoha/Kconfig
```kconfig
# SPDX-License-Identifier: GPL-2.0-only

config PCS_AIROHA
	tristate
	select PHYLINK
	select FWNODE_PCS
	select MFD_SYSCON
	select REGMAP_MMIO
	select GENERIC_PHY

config PCS_AIROHA_AN7581
	tristate "Airoha AN7581 PCS driver"
	depends on ARCH_AIROHA || COMPILE_TEST
	select PCS_AIROHA
	help
	  This module provides helper to phylink for managing the Airoha
	  AN7581 PCS for SoC Ethernet and PON SERDES.
```
