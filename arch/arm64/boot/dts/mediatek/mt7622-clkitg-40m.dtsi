&clkitg {
	bring-up {
		compatible = "mediatek,clk-bring-up";
		clocks =
			<&apmixedsys CLK_APMIXED_ARMPLL>,
			<&apmixedsys CLK_APMIXED_MAINPLL>,
			<&apmixedsys CLK_APMIXED_UNIV2PLL>,
			<&clk40m>,
			<&clk40m>,
			<&apmixedsys CLK_APMIXED_AUD1PLL>,
			<&apmixedsys CLK_APMIXED_AUD2PLL>,
			<&clk40m>,
			<&clk40m>,
			<&clk40m>,
			<&clk40m>,
			<&clk40m>,
			<&clk40m>,
			<&clk40m>,
			<&pericfg CLK_PERI_THERM_PD>,
			<&clk40m>,
			<&clk40m>,
			<&clk40m>,
			<&clk40m>,
			<&clk40m>,
			<&clk40m>,
			<&clk40m>,
			<&clk40m>,
			<&pericfg CLK_PERI_AP_DMA_PD>,
			<&clk40m>,
			<&clk40m>,
			<&pericfg CLK_PERI_UART0_PD>,
			<&clk40m>,
			<&clk40m>,
			<&clk40m>,
			<&clk40m>,
			<&clk40m>,
			<&clk40m>,
			<&clk40m>,
			<&clk40m>,
			<&clk40m>,
			<&clk40m>,
			<&clk40m>,
			<&clk40m>,
			<&pericfg CLK_PERI_SNFI_PD>,
			<&pericfg CLK_PERI_NFI_PD>,
			<&pericfg CLK_PERI_NFIECC_PD>,
			<&pericfg CLK_PERI_FLASH_PD>,
			<&clk40m>,
			<&clk40m>,
			<&clk40m>,
			<&clk40m>,
			<&clk40m>,
			<&clk40m>,
			<&clk40m>,
			<&clk40m>,
			<&clk40m>,
			<&clk40m>,
			<&clk40m>,
			<&clk40m>,
			<&clk40m>,
			<&clk40m>,
			<&clk40m>,
			<&clk40m>,
			<&clk40m>,
			<&clk40m>,
			<&clk40m>,
			<&clk40m>,
			<&clk40m>,
			<&clk40m>,
			<&clk40m>,
			<&clk40m>,
			<&clk40m>,
			<&clk40m>,
			<&clk40m>,
			<&clk40m>,
			<&clk40m>,
			<&clk40m>,
			<&clk40m>,
			<&clk40m>,
			<&clk40m>,
			<&clk40m>,
			<&clk40m>,
			<&clk40m>,
			<&clk40m>,
			<&clk40m>,
			<&clk40m>,
			<&clk40m>,
			<&clk40m>,
			<&clk40m>,
			<&clk40m>,
			<&clk40m>,
			<&clk40m>,
			<&clk40m>,
			<&clk40m>,
			<&clk40m>,
			<&clk40m>,
			<&clk40m>,
			<&clk40m>,
			<&clk40m>,
			<&clk40m>,
			<&clk40m>,
			<&clk40m>,
			<&clk40m>,
			<&clk40m>,
			<&ssusbsys CLK_SSUSB_U2_PHY_1P_EN>,
			<&ssusbsys CLK_SSUSB_U2_PHY_EN>,
			<&ssusbsys CLK_SSUSB_REF_EN>,
			<&ssusbsys CLK_SSUSB_SYS_EN>,
			<&ssusbsys CLK_SSUSB_MCU_EN>,
			<&ssusbsys CLK_SSUSB_DMA_EN>,
			<&clk40m>,
			<&clk40m>,
			<&clk40m>,
			<&clk40m>,
			<&clk40m>,
			<&clk40m>,
			<&clk40m>,
			<&clk40m>,
			<&clk40m>,
			<&clk40m>,
			<&clk40m>,
			<&clk40m>,
			<&clk40m>,
			<&clk40m>,
			<&clk40m>,
			<&clk40m>,
			<&clk40m>,
			<&ethsys CLK_ETH_HSDMA_EN>,
			<&clk40m>,
			<&clk40m>,
			<&clk40m>,
			<&clk40m>,
			<&clk40m>,
			<&clk40m>,
			<&clk40m>,
			<&clk40m>;

		clock-names = "0", "1", "2", "3", "4", "5", "6", "7", "8", "9", "10", "11",
		"12", "13", "14", "15", "16", "17", "18", "19", "20", "21", "22", "23",
		"24", "25", "26", "27", "28", "29", "30", "31", "32", "33", "34", "35",
		"36", "37", "38", "39", "40", "41", "42", "43", "44", "45", "46", "47",
		"48", "49", "50", "51", "52", "53", "54", "55", "56", "57", "58", "59",
		"60", "61", "62", "63", "64", "65", "66", "67", "68", "69", "70", "71",
		"72", "73", "74", "75", "76", "77", "78", "79", "80", "81", "82", "83",
		"84", "85", "86", "87", "88", "89", "90", "91", "92", "93", "94", "95",
		"96", "97", "98", "99", "100", "101", "102", "103", "104", "105", "106",
		"107", "108", "109", "110", "111", "112", "113", "114", "115", "116", "117",
		"118", "119", "120", "121", "122", "123", "124", "125";
	};

	bring-up-pd-hif1 {
			compatible = "mediatek,scpsys-bring-up";
			power-domains = <&scpsys MT7622_POWER_DOMAIN_HIF1>;
	};
};
