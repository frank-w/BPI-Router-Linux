// SPDX-License-Identifier: (GPL-2.0 OR MIT)
/*
 * Copyright (C) 2025 MediaTek Inc.
 * Author: Frank Wunderlich <frank-w@public-files.de>
 */

/* This enables WAN-SFP on BPI-R4-Pro */

/dts-v1/;
/plugin/;

#include <dt-bindings/gpio/gpio.h>

/ {
	compatible = "bananapi,bpi-r4-pro", "mediatek,mt7988a";
};

&{/soc/ethernet@15100000/mac@1} {
	sfp = <&sfp2>;
	managed = "in-band-status";
	phy-mode = "usxgmii";
	openwrt,netdev-name = "sfp-wan";
	status = "okay";
};

&{/soc/pinctrl@1001f000} {
	wan-sfp-hog {
		gpio-hog;
		gpios = <3 GPIO_ACTIVE_HIGH>;
		output-high; /* select sfp */
	};
};
