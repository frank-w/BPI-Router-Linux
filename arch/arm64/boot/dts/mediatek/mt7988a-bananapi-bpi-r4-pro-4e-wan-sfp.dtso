// SPDX-License-Identifier: (GPL-2.0 OR MIT)
/*
 * Author: Wilfried Teiken <wteiken@teiken.org>
 */

/* This enables the SFP+ cage 2 on BPI-R4-Pro-4E */

/dts-v1/;
/plugin/;

/ {
	compatible = "bananapi,bpi-r4-pro-4e", "mediatek,mt7988a";
};

&gmac1 {
        managed = "in-band-status";
        phy-mode = "usxgmii";
        sfp = <&sfp2>;
        status = "okay";
};
