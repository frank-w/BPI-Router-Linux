// SPDX-License-Identifier: (GPL-2.0 OR MIT)
/*
 * Copyright (C) 2023 MediaTek Inc.
 * Author: Frank Wunderlich <frank-w@public-files.de>
 */

/dts-v1/;
/plugin/;

#include <dt-bindings/gpio/gpio.h>

/ {
	compatible = "bananapi,bpi-r4", "mediatek,mt7988a";

	fragment@0 {
		target-path = "/";
		__overlay__ {
			reg_3p3v: regulator-3p3v {
				compatible = "regulator-fixed";
				regulator-name = "fixed-3.3V";
				regulator-min-microvolt = <3300000>;
				regulator-max-microvolt = <3300000>;
				regulator-boot-on;
				regulator-always-on;
			};
		};
	};

	fragment@2 {
		target-path = "/soc/mmc@11230000";
		__overlay__ {
			pinctrl-names = "default", "state_uhs";
			pinctrl-0 = <&mmc0_pins_sdcard>;
			pinctrl-1 = <&mmc0_pins_sdcard>;
			cd-gpios = <&pio 69 GPIO_ACTIVE_LOW>;
			bus-width = <4>;
			max-frequency = <52000000>;
			cap-sd-highspeed;
			vmmc-supply = <&reg_3p3v>;
			vqmmc-supply = <&reg_3p3v>;
			no-mmc;
			status = "okay";
		};
	};
};
