// SPDX-License-Identifier: (GPL-2.0 OR MIT)
/*
 * Copyright (C) 2025 MediaTek Inc.
 * Author: Frank Wunderlich <frank-w@public-files.de>
 */

/dts-v1/;
/plugin/;

#include <dt-bindings/gpio/gpio.h>

/ {
	compatible = "bananapi,bpi-r4-lite", "mediatek,mt7987a";
};

&{/soc/mmc@11230000} {
	max-frequency = <52000000>;
	pinctrl-names = "default", "state_uhs";
	pinctrl-0 = <&sd_pins_default>;
	pinctrl-1 = <&sd_pins_uhs>;
	cd-gpios = <&pio 20 GPIO_ACTIVE_LOW>;
	bus-width = <4>;
	cap-sd-highspeed;
	vmmc-supply = <&reg_3p3v>;
	vqmmc-supply = <&reg_3p3v>;
	no-mmc;
	#address-cells = <1>;
	#size-cells = <0>;
	status = "okay";
};

