// SPDX-License-Identifier: (GPL-2.0 OR MIT)
/*
 * Copyright (C) 2025 MediaTek Inc.
 * Author: Frank Wunderlich <frank-w@public-files.de>
 */

/* This enables key-m slot CN14 on pcie3(11290000 1L1) on BPI-R4-Pro */

/dts-v1/;
/plugin/;

#include <dt-bindings/gpio/gpio.h>

/ {
	compatible = "bananapi,bpi-r4-pro", "mediatek,mt7988a";
};

&pio {
        pcie-3-hog {
                gpio-hog;
                gpios = <63 GPIO_ACTIVE_HIGH>;
                output-high;
        };
};
