// SPDX-License-Identifier: GPL-2.0-only OR MIT

/dts-v1/;

#include "mt7988a-bananapi-bpi-r4.dtsi"

/ {
	model = "Bananapi BPI-R4 2.5GE";
};

&gmac1 {
	phy-mode = "internal";
	phy-connection-type = "internal";
	phy = <&int_2p5g_phy>;
	status = "okay";
	openwrt,netdev-name = "lan4";
};

&int_2p5g_phy {
	pinctrl-names = "i2p5gbe-led";
	pinctrl-0 = <&i2p5gbe_led0_pins>;
};
