// SPDX-License-Identifier: (GPL-2.0 OR MIT)
/*
 * Copyright (C) 2025 MediaTek Inc.
 * Author: Sam.Shih <sam.shih@mediatek.com>
 */
/dts-v1/;
/plugin/;
#include <dt-bindings/gpio/gpio.h>

&{/soc/pinctrl@1001f000/pcie-1-hog} {
	output-high;
};


&{/soc/pcie@11290000} {
	status = "disabled";
};
